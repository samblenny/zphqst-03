## CMakeLists.txt
```
# SPDX-FileCopyrightText: Copyright 2025 Sam Blenny
# SPDX-License-Identifier: Apache-2.0

cmake_minimum_required(VERSION 3.20)
find_package(Zephyr)
project(zphqst_03)
target_sources(app PRIVATE
	src/main.c
	src/zq3_dns.c
	src/zq3_mqtt.c
	src/zq3_lvgl.c
	src/zq3_url.c
	src/zq3_wifi.c
)
```

## prj.conf
```kconfig
# SPDX-FileCopyrightText: Copyright 2025 Sam Blenny
# SPDX-License-Identifier: Apache-2.0

CONFIG_EARLY_CONSOLE=y
CONFIG_LOG_MODE_IMMEDIATE=y
CONFIG_GPIO=y
CONFIG_INPUT=y
CONFIG_HEAP_MEM_POOL_SIZE=51200
CONFIG_LV_Z_MEM_POOL_SIZE=40960
CONFIG_MAIN_STACK_SIZE=5200
CONFIG_SHELL_STACK_SIZE=9216

# Support for saving settings in flash at runtime (see shell config below)
CONFIG_FLASH=y
CONFIG_FLASH_MAP=y
CONFIG_NVS=y
CONFIG_SETTINGS=y
CONFIG_SETTINGS_NVS=y
CONFIG_SETTINGS_RUNTIME=y
# For default storage partition at 0x3b0000 of size 0x30000
CONFIG_SETTINGS_NVS_SECTOR_COUNT=48

# Enable networking with wifi
CONFIG_NETWORKING=y
CONFIG_POSIX_API=y
CONFIG_NET_L2_ETHERNET=y
CONFIG_WIFI=y
CONFIG_ESP32_WIFI_STA_AUTO_DHCPV4=y

# Networking debug stuff (watch packets & protocol progress)
#CONFIG_NET_TCP_LOG_LEVEL_DBG=y
CONFIG_LOG_MODE_MINIMAL=y

# Something about the original CONFIG_NET_* settings I was using caused my wifi
# router and/or Debian MQTT test server to drop packets. I'm not sure why.
# During testing I had to reset the router and Debian wifi interface many
# times. After experimenting with different CONFIG_NET_* settings, I ended up
# with this config which seems to behave much better. Possible that the net
# stack was glitching due to memory allocation errors.
#
# For net stack config options, see:
# https://docs.zephyrproject.org/latest/connectivity/networking/net_config_guide.html
# - Ethernet maximum transmission unit (MTU) is 1500 bytes
# - For 2 full frame RX at CONFIG_NET_BUF_DATA_SIZE=128 (the default), then
#   net packet RX count is 2. Net buffer RX count is 2*1500/128 = 23.4 which
#   rounds up to 24. But, using TCP needs more for queueing packets.

# TX capacity: 6 full size packets
CONFIG_NET_PKT_TX_COUNT=6
CONFIG_NET_BUF_TX_COUNT=70
CONFIG_NET_TX_STACK_SIZE=8960
# RX capacity: 10 full size packets
CONFIG_NET_PKT_RX_COUNT=10
CONFIG_NET_BUF_RX_COUNT=118
CONFIG_NET_RX_STACK_SIZE=15104
# 1 context = 1 BSD socket listener or sender
CONFIG_NET_MAX_CONTEXTS=10
CONFIG_NET_MGMT_EVENT_QUEUE_TIMEOUT=5000
CONFIG_NET_MGMT_EVENT_QUEUE_SIZE=16

CONFIG_NET_IPV4=y
CONFIG_NET_IPV6=n
CONFIG_NET_DHCPV4=y
CONFIG_NET_TCP=y
CONFIG_NET_UDP=y
CONFIG_NET_LOG=y

CONFIG_DNS_RESOLVER=y
CONFIG_MQTT_LIB=y
CONFIG_MQTT_LIB_TLS=y

CONFIG_DISPLAY=y
CONFIG_DISPLAY_LOG_LEVEL_ERR=y

CONFIG_LVGL=y
CONFIG_LV_USE_LOG=y
CONFIG_LV_USE_LABEL=y
CONFIG_LV_FONT_DEFAULT_MONTSERRAT_14=n
CONFIG_LV_FONT_DEFAULT_MONTSERRAT_18=y
CONFIG_LV_USE_ANIMIMG=n
CONFIG_LV_USE_CALENDAR=n

CONFIG_SHELL=y
CONFIG_SHELL_HISTORY=y
CONFIG_SETTINGS_SHELL=y
CONFIG_FLASH_MAP_SHELL=y
CONFIG_FLASH_SHELL=y
CONFIG_FLASH_SHELL_TEST_COMMANDS=y

CONFIG_NET_SHELL=n
CONFIG_SHELL_STATS=n
CONFIG_SHELL_CMDS=n
CONFIG_DATE_SHELL=n
CONFIG_DEVICE_SHELL=n
CONFIG_DEVMEM_SHELL=n
CONFIG_KERNEL_SHELL=n
CONFIG_NET_SHELL_SHOW_DISABLED_COMMANDS=n
```

## app.overlay
```dts
/*
 * SPDX-FileCopyrightText: Copyright 2025 Sam Blenny
 * SPDX-License-Identifier: Apache-2.0
 *
 * This configures a flash partition for use with the Settings API
 *
 * Related:
 * - zephyr/dts/common/espressif/partitions_0x0_amp_4M.dtsi
 */

/ {
	chosen {
		zephyr,settings-partition = &storage_partition;
	};
};

&storage_partition {
	label = "settings";
};
```

## src/main.c
```c
/*
 * SPDX-FileCopyrightText: Copyright 2025 Sam Blenny
 * SPDX-License-Identifier: Apache-2.0
 *
 * Wifi + Network Manager Docs & Refs:
 * https://docs.zephyrproject.org/latest/doxygen/html/group__net__mgmt.html
 * https://docs.zephyrproject.org/latest/doxygen/html/structnet__mgmt__event__callback.html
 * https://github.com/zephyrproject-rtos/zephyr/blob/main/subsys/net/l2/wifi/wifi_shell.c
 */

#include <zephyr/kernel.h>
#include <zephyr/net/mqtt.h>
#include <zephyr/net/wifi_mgmt.h>     // NET_EVENT_WIFI_CONNECT_RESULT, ...
#include <zephyr/settings/settings.h>
#include <zephyr/shell/shell.h>
#include "zq3.h"
#include "zq3_mqtt.h"
#include "zq3_lvgl.h"
#include "zq3_url.h"
#include "zq3_wifi.h"


/*
* STATIC GLOBALS AND CONSTANTS
*/

// Context for wifi status, mqtt config, and mqtt status
static zq3_context ZCtx = {
	.ssid = {'\0'},
	.psk =  {'\0'},
	.user = {'\0'},
	.pass = {'\0'},
	.host = {'\0'},
	.topic = {'\0'},
	.tls = true,
	.mqtt_ok = false,
	.state = OFFLINE,
	.keypress = false,
	.got_0 = false,
	.got_1 = false,
	.toggle = UNKNOWN,
};

struct sockaddr_storage AIOBroker;

// MQTT context struct
static struct mqtt_client Ctx;


/*
* NETWORK EVENT HANDLERS
*/

// Handle MQTT events.
// Related docs:
// - https://docs.zephyrproject.org/latest/doxygen/html/structmqtt__evt.html
// - https://docs.zephyrproject.org/latest/doxygen/html/unionmqtt__evt__param.html
// - https://docs.zephyrproject.org/latest/doxygen/html/structmqtt__publish__param.html
// - https://docs.zephyrproject.org/latest/doxygen/html/structmqtt__publish__message.html
// - https://docs.zephyrproject.org/latest/doxygen/html/structmqtt__topic.html
// - https://docs.zephyrproject.org/latest/doxygen/html/structmqtt__binstr.html
//
static void mq_handler(struct mqtt_client *client, const struct mqtt_evt *e) {
	switch (e->type) {
	case MQTT_EVT_CONNACK:
		ZCtx.state = CONNACK;
		break;
	case MQTT_EVT_DISCONNECT:
		printk("DISCONNECT\n");
		ZCtx.state = MQTT_ERR;
		ZCtx.toggle = UNKNOWN;   // because we're no longer subscribed
		break;
	case MQTT_EVT_PUBLISH:
		// This happens when the broker informs us that somebody published a
		// message to a topic we have subscribed to. The parameter, e->param,
		// will be of type mqtt_publish_param.

		// First extract topic from the param struct and check for match
		const struct mqtt_publish_message *m = &e->param.publish.message;
		const uint8_t *topic = m->topic.topic.utf8;
		uint32_t t_len = m->topic.topic.size;
		if (t_len >= sizeof(ZCtx.topic)
			|| memcmp(topic, ZCtx.topic, t_len)
		) {
			printk("ignoring unknown topic (len = %d)\n", t_len);
			return;
		}

		// Second, get the payload data and parse it.
		// CAUTION: You can't get the payload data from the payload struct.
		// Instead you have to call this function (see mqtt_evt_type docs).
		uint8_t buf[32] = {0};
		uint32_t payload_len = m->payload.len;
		int count = mqtt_read_publish_payload(&Ctx, buf, sizeof(buf));
		if (count != 1 || count != payload_len) {
			printk("ERR: unexpected payload length: %d\n", count);
			return;
		}

		// Parse payload data for expected messages: "1" or "0"
		switch((char)buf[0]) {
		case '0':
			printk("PUB GOT 0\n");
			ZCtx.got_0 = true;
			break;
		case '1':
			printk("PUB GOT 1\n");
			ZCtx.got_1 = true;
			break;
		default:
			printk("PUB GOT unknown value\n");
		}
		break;
	case MQTT_EVT_SUBACK:
		ZCtx.state = SUBACK;
		break;
	case MQTT_EVT_PINGRESP:
		// This can be useful, but it's noisy
		//printk("PINGRESP\n");
		break;
	default:
		break;
	}
}

// Handle network manager events (wifi up / wifi down)
static void net_callback(
	struct net_mgmt_event_callback *cb,
	uint32_t mgmt_event,
	struct net_if *iface
) {
	switch(mgmt_event) {
	case NET_EVENT_WIFI_CONNECT_RESULT:
		printk("NET_EVENT_WIFI_CONNECT_RESULT\n");
		ZCtx.state = WIFI_UP;
		break;
	case NET_EVENT_WIFI_DISCONNECT_RESULT:
		printk("NET_EVENT_WIFI_DISCONNECT_RESULT\n");
		ZCtx.state = WIFI_ERR;
		break;
	default:
		printk("net: unknown event\n");
	}
}


/*
* SHELL COMMANDS
*/

// Connect to Wifi
static int cmd_wifi_up(const struct shell *shell, size_t argc, char *argv[]) {
	return zq3_wifi_connect(ZCtx.ssid, ZCtx.psk);
}

// Disconnect from Wifi
static int cmd_wifi_dn(const struct shell *shell, size_t argc, char *argv[]) {
	return zq3_wifi_disconnect();
}

// Connect to MQTT broker
static int cmd_up(const struct shell *shell, size_t argc, char *argv[]) {
	int err = zq3_mqtt_connect(&ZCtx, &Ctx);
	if (err) {
		ZCtx.state = MQTT_ERR;
		return err;
	}
	ZCtx.state = CONNWAIT;
	return 0;
}

// Disconnect from MQTT broker
static int cmd_dn(const struct shell *shell, size_t argc, char *argv[]) {
	int err = zq3_mqtt_disconnect(&Ctx);
	if (err) {
		ZCtx.state = MQTT_ERR;
		return err;
	}
	ZCtx.state = MQTT_ERR;  // CAUTION: WIFI_UP would trigger a reconnect
	return 0;
}

// Reload settings. (you can use this after `settings write ...`)
static int cmd_reload(const struct shell *shell, size_t argc, char *argv[]) {
	// Clear wifi and MQTT settings from context struct
	memset(ZCtx.ssid, 0, sizeof(ZCtx.ssid));
	memset(ZCtx.psk, 0, sizeof(ZCtx.psk));
	memset(ZCtx.user, 0, sizeof(ZCtx.user));
	memset(ZCtx.pass, 0, sizeof(ZCtx.pass));
	memset(ZCtx.host, 0, sizeof(ZCtx.host));
	memset(ZCtx.topic, 0, sizeof(ZCtx.topic));
	ZCtx.tls = false;
	ZCtx.mqtt_ok = false;
	// Load saved settings
	return settings_load();
}

// These macros add the `aio *` shell commands for controlling the MQTT broker
// connection in the Zephyr shell over USB serial. MQTT broker config gets
// read from 'zq3/url' setting stored in NVM flash (`settings write ...`).
//
SHELL_STATIC_SUBCMD_SET_CREATE(aio_cmds,
	SHELL_CMD(wifi_up, NULL, "Wifi connect", cmd_wifi_up),
	SHELL_CMD(wifi_dn, NULL, "Wifi disconnect", cmd_wifi_dn),
	SHELL_CMD(up, NULL, "AIO MQTT broker connect", cmd_up),
	SHELL_CMD(dn, NULL, "AIO MQTT broker disconnect", cmd_dn),
	SHELL_CMD(reload, NULL, "Reload settings", cmd_reload),
	SHELL_SUBCMD_SET_END
);


/*
* SETTINGS READING CALLBACKS
* To write settings to flash, use the Zephyr shell `settings` command.
* Docs:
* - https://docs.zephyrproject.org/latest/services/storage/settings/index.html
* - https://docs.zephyrproject.org/latest/doxygen/html/group__settings.html
*/

// This callback runs each time settings_load() reads a key from the NVM flash
// backend which matches the configured prefix. The API docs confusingly refer
// to this as "set" callback. The semantics seem like what I'd expect from a
// getter. But, whatever. To read the saved values of keys, this works.
//
static int
set_cb(const char *key, size_t len, settings_read_cb read_cb, void *cb_arg)
{
	char buf[256];
	if (len >= sizeof(buf)) {
		printk("setting value for key '%s' is too big: %d\n", key, len);
		return -EMSGSIZE;
	}
	int rc = read_cb(cb_arg, buf, sizeof(buf));
	if (rc < 0) {
		printk("ERR: settings read_cb(%s) = %d\n", key, rc);
		return rc;
	}
	buf[sizeof(buf)-1] = '\0';  // make sure string is null terminated
	int vlen = strlen(buf);
	if (strcmp("url", key) == 0) {
		// Parse MQTT URL and save components to context struct
		if (vlen >= ZQ3_URL_MAX_LEN) {
			printk("ERR: setting for '%s' is too long: %d\n", key, vlen);
			return -EOVERFLOW;
		}
		int err = zq3_url_parse(&ZCtx, buf);
		if (err) {
			printk("ERR settings: failed to parse url: %d\n", err);
			return err;
		}
		// Success
		ZCtx.mqtt_ok = true;
		// Update string lengths in MQTT context (see main() inits section)
		if(Ctx.password != NULL) {
			Ctx.password->size = strlen(Ctx.password->utf8);
		}
		if(Ctx.user_name != NULL) {
			Ctx.user_name->size = strlen(Ctx.user_name->utf8);
		}
	} else if (strcmp("ssid", key) == 0) {
		// Save Wifi SSID to context struct
		if (vlen >= sizeof(ZCtx.ssid)) {
			printk("ERR: setting for '%s' is too long: %d\n", key, vlen);
			return -EOVERFLOW;
		}
		memset(ZCtx.ssid, 0, sizeof(ZCtx.ssid));
		memcpy(ZCtx.ssid, buf, vlen);
	} else if (strcmp("psk", key) == 0) {
		// Save Wifi passphrase to context struct
		if (vlen >= sizeof(ZCtx.psk)) {
			printk("ERR: setting for '%s' is too long: %d\n", key, vlen);
			return -EOVERFLOW;
		}
		memset(ZCtx.psk, 0, sizeof(ZCtx.psk));
		memcpy(ZCtx.psk, buf, vlen);
	}
	printk("Settings SET: '%s'\n", key);
	return 0;
}

// This macro configures the callbacks to be invoked by settings_load()
SETTINGS_STATIC_HANDLER_DEFINE(zq3, "zq3", NULL, set_cb, NULL, NULL);


/*
* KEYPAD BUTTON PRESS CALLBACK
*/

// Callback to handle keypad input events
static void keypad_pressed_callback(lv_event_t *event) {
	ZCtx.keypress = true;
}


/*
* MAIN
*/

int main(void) {
	// Inits
	struct net_mgmt_event_callback net_status;
	zq3_lvgl_context LCtx;
	zq3_lvgl_init(&LCtx, keypad_pressed_callback);
	SHELL_CMD_REGISTER(aio, &aio_cmds, "Adafruit IO MQTT commands", NULL);
	settings_subsys_init();
	printk("Loading Settings\n");
	settings_load();

	// MQTT Init
	mqtt_client_init(&Ctx);
	uint8_t MQRxBuf[256];
	uint8_t MQTxBuf[256];
	struct mqtt_utf8 pass = {(uint8_t *)ZCtx.pass, strlen(ZCtx.pass)};
	struct mqtt_utf8 user = {(uint8_t *)ZCtx.user, strlen(ZCtx.user)};
	Ctx.broker = &AIOBroker;
	Ctx.evt_cb = mq_handler;
	Ctx.client_id.utf8 = (uint8_t *)"id";  // protocol requires non-empty id
	Ctx.client_id.size = strlen("id");
	Ctx.password = &pass;
	Ctx.user_name = &user;
	Ctx.protocol_version = MQTT_VERSION_3_1_1;
	Ctx.transport.type = MQTT_TRANSPORT_NON_SECURE;  // TODO: use TLS
	Ctx.rx_buf = MQRxBuf;
	Ctx.rx_buf_size = sizeof(MQRxBuf);
	Ctx.tx_buf = MQTxBuf;
	Ctx.tx_buf_size = sizeof(MQTxBuf);
	// TODO: add TLS support
	// Ctx.transport.type = MQTT_TRANSPORT_SECURE;
	// struct mqtt_sec_config *conf = &Ctx.transport.tls.config;
	// conf->cipher_list = NULL;
	// conf->hostname = MQTT_BROKER_HOSTNAME;

	// Register to get updates about wifi connection status
	net_mgmt_init_event_callback(&net_status, net_callback,
		NET_EVENT_WIFI_CONNECT_RESULT | NET_EVENT_WIFI_DISCONNECT_RESULT);
	net_mgmt_add_event_callback(&net_status);

	// Event loop
	zq3_state prev_state = ZCtx.state;
	zq3_toggle prev_toggle = ZCtx.toggle;
	zq3_lvgl_timer_handler();
	const char *offline_message = "Press\nBOOT button\nto connect";
	zq3_lvgl_show_message(&LCtx, offline_message);
	while(1) {
		int err;
		// Update GUI when Wifi/MQTT connection state changes
		if (prev_state != ZCtx.state) {
			prev_state = ZCtx.state;
			switch(ZCtx.state) {
			case OFFLINE:
				// This happens when wifi disconnects for some reason
				printk("[OFFLINE]\n");
				zq3_lvgl_wifi_status(&LCtx, false);
				zq3_lvgl_show_message(&LCtx, offline_message);
				break;
			case WIFI_ERR:
				printk("[WIFI_ERR]\n");
				zq3_lvgl_wifi_status(&LCtx, false);
				zq3_lvgl_show_message(&LCtx, "Wifi Error\n(check settings)");
				break;
			case WIFIWAIT:
				printk("[WIFIWAIT]\n");
				zq3_lvgl_show_message(&LCtx, "Connecting...");
				break;
			case WIFI_UP:
				// Light up the wifi icon in the statusbar
				printk("[WIFI_UP]\n");
				zq3_lvgl_wifi_status(&LCtx, true);
				// Attempt to connect to the MQTT broker (once)
				int err = zq3_mqtt_connect(&ZCtx, &Ctx);
				if (err) {
					ZCtx.state = MQTT_ERR;
				} else {
					ZCtx.state = CONNWAIT;
				}
				break;
			case MQTT_ERR:
				// Problem with MQTT settings, broker unreachable, etc.
				printk("[MQTT_ERR]\n");
				zq3_lvgl_show_message(&LCtx, "MQTT Error\n(check settings)");
				break;
			case CONNWAIT:
				// MQTT is connecting... just wait silently
				printk("[CONWAIT]\n");
				break;
			case CONNACK:
				// MQTT connected, so subscribe to topic
				printk("[CONNACK]\n");
				err = zq3_mqtt_subscribe(&ZCtx, &Ctx);
				if (err) {
					ZCtx.state = MQTT_ERR;
				} else {
					ZCtx.state = SUBWAIT;
				}
				break;
			case SUBWAIT:
				printk("[SUBWAIT]\n");
				break;
			case SUBACK:
				printk("[SUBACK]\n");
				ZCtx.state = READY;
				break;
			case READY:
				printk("[READY]\n");

				// Reset toggle switch state to UNKNOWN/not-checked. It would
				// be possible to ask the broker for the topic's old value, but
				// I'm skipping that to keep the code simpler.
				ZCtx.toggle = UNKNOWN;
				zq3_lvgl_set_toggle(&LCtx, false);

				// Show the toggle switch in place of the status message
				zq3_lvgl_show_toggle(&LCtx);
				break;
			}
		}

		// Maintain MQTT connection (note: poll() requires CONFIG_POSIX_API=y)
		if (ZCtx.state >= CONNWAIT) {
			// Respond to incoming MQTT messages if needed
			if (poll(ZCtx.fds, 1, 0) > 0) {
				mqtt_input(&Ctx);
			}

			// Send an MQTT PINGREQ ping several seconds before the keepalive
			// timer is due to run out. This keeps the TCP connection to the
			// MQTT broker open so it can send us messages on subscribed topics
			// as they are published.
			int remaining_ms = mqtt_keepalive_time_left(&Ctx);
			if (remaining_ms < 5000) {
				mqtt_live(&Ctx);
			}
		}

		// If keypad press callback set the button press flag, handle it
		if (ZCtx.keypress) {
			ZCtx.keypress = false;
			switch(ZCtx.state) {
			case WIFI_ERR:
				// Retry from error state (maybe after changing settings)...
				// fall through to the OFFLINE case
			case OFFLINE:
				// Attempt to start a wifi connection
				printk("starting wifi connection\n");
				err = zq3_wifi_connect(ZCtx.ssid, ZCtx.psk);
				if (err) {
					ZCtx.state = WIFI_ERR;
					printk("ERR: wifi connect: %d\n", err);
				} else {
					ZCtx.state = WIFIWAIT;
				}
				break;
			case MQTT_ERR:
				// Trigger an MQTT connection retry attempt (maybe after
				// changing settings, fixing the MQTT broker, or whatever)
				ZCtx.state = WIFI_UP;
				break;
			case READY:
				// MQTT is up and ready: key press means toggle the switch
				// and publish its new value.
				//
				// This will apply the following transformations to .toggle:
				//   UKNOWN becomes ON
				//   OFF    becomes ON
				//   ON     becomes OFF
				bool new_state = ZCtx.toggle != ON;
				ZCtx.toggle = new_state ? ON : OFF;
				printk("Publishing toggle state: %d\n", new_state ? 1 : 0);
				err = zq3_mqtt_publish(&ZCtx, &Ctx, new_state);
				if (err) {
					ZCtx.state = MQTT_ERR;
				}
				break;
			default:
				printk("Keypad pressed (NOP)\n");
			}
		}

		// Check if MQTT message requested a change to the toggle state
		if (ZCtx.got_0) {
			ZCtx.got_0 = false;
			ZCtx.toggle = OFF;
		}
		if (ZCtx.got_1) {
			ZCtx.got_1 = false;
			ZCtx.toggle = ON;
		}

		// Update toggle button widget if toggle stated has changed
		if (prev_toggle != ZCtx.toggle) {
			prev_toggle = ZCtx.toggle;
			switch(ZCtx.toggle) {
			case UNKNOWN:
				/* NOP */
				break;
			case OFF:
				zq3_lvgl_set_toggle(&LCtx, false);
				break;
			case ON:
				zq3_lvgl_set_toggle(&LCtx, true);
				break;
			}
		}

		// Call LVGL then sleep until time for the next tick
		uint32_t holdoff_ms = zq3_lvgl_timer_handler();
		k_msleep(holdoff_ms);
	}
}
```

## src/zq3.h
```c
/*
 * SPDX-FileCopyrightText: Copyright 2025 Sam Blenny
 * SPDX-License-Identifier: Apache-2.0
 */
#ifndef ZQ3_H
#define ZQ3_H

#include <zephyr/net/socket.h>  /* pollfd */


// Sequence of connection states from no-connectivity up to mqtt-ready-to-go.
typedef enum {
	OFFLINE,   // waiting for button press to initiate wifi connection
	WIFI_ERR,  // waiting for wifi error recovery (something went wrong)
	WIFIWAIT,  // waiting for wifi to connect
	WIFI_UP,   // wifi up, mqtt not connected to broker yet
	MQTT_ERR,  // waiting for error recovery (something went wrong)
	CONNWAIT,  // waiting for MQTT CONNACK event
	CONNACK,   // subscribe to MQTT topic
	SUBWAIT,   // waiting for MQTT SUBACK
	SUBACK,    // publish to /get topic modifier
	READY,     // task: respond to button pushes or publish events
} zq3_state;

// Possible states for local cached value of an MQTT toggle switch topic
typedef enum {
	UNKNOWN,  // toggle state unknown (because no MQTT connection yet, etc)
	OFF,      // toggle is off
	ON,       // toggle is on
} zq3_toggle;

// Adafruit IO MQTT broker auth credentials, hostname, topic, and scheme
typedef struct {
	char ssid[32];       // wifi ssid
	char psk[64];        // wifi WPA2 passphrase
	char user[48];       // MQTT username
	char pass[48];       // MQTT password
	char host[48];       // MQTT broker's hostname
	char topic[48];      // MQTT topic
	bool tls;            // MQTT should use TLS
	bool mqtt_ok;        // MQTT configuration is valid (url parse worked)
	zq3_state state;     // MQTT connection state (independent of wifi)
	bool keypress;       // flag to notify main loop of lvgl keypad press
	bool got_0;          // flag for receiving MQTT PUBLISH message "0"
	bool got_1;          // flag for receiving MQTT PUBLISH message "1"
	zq3_toggle toggle;   // current state of toggle switch
	// For the fds file descriptor array, the examples in Zephyr project MQTT
	// docs use the pollfd type and the poll() function, both of which gave me
	// compiler errors until I figured out I needed CONFIG_POSIX_API=y. Note
	// that docs may refer to zsock_pollfd and zsock_poll(). See
	// zephyr/net/socket.h.
	struct pollfd fds[1];
} zq3_context;

#define ZQ3_URL_MAX_LEN (sizeof("mqtts://:@") + \
	sizeof(((zq3_context *)0)->user) + sizeof(((zq3_context *)0)->pass) + \
	sizeof(((zq3_context *)0)->host) + sizeof(((zq3_context *)0)->topic))

#define ZQ3_MSG_MAX_LEN (128)


#endif /* ZQ3_H */
```

## src/zq3_dns.c
```c
/*
 * SPDX-FileCopyrightText: Copyright 2025 Sam Blenny
 * SPDX-License-Identifier: Apache-2.0
 *
 * DNS & Socket Docs & Refs:
 * https://docs.zephyrproject.org/apidoc/latest/group__bsd__sockets.html
 * https://docs.zephyrproject.org/apidoc/latest/netdb_8h.html (getaddrinfo / freeaddrinfo)
 * https://github.com/zephyrproject-rtos/zephyr/blob/main/include/zephyr/net/dns_resolve.h
 * https://docs.zephyrproject.org/apidoc/latest/group__ip__4__6.html (net_addr_ntop)
 */

#include <zephyr/net/socket.h>
#include "zq3.h"


#define TLS_PORTSTR     ("8883")
#define TLS_PORT        (8883)
#define NON_TLS_PORTSTR ("1883")
#define NON_TLS_PORT    (1883)

// Resolve hostname to IPv4 IP (IPv6 not supported)
// This requires CONFIG_POSIX_API=y and CONFIG_NET_SOCKETS_POSIX_NAMES=y.
//
int zq3_dns_resolve(zq3_context *zctx, struct sockaddr_storage *broker) {
	if (zctx == NULL || broker == NULL) {
		return 1;
	}
	struct addrinfo *res = NULL;
	const struct addrinfo hint = {
		.ai_family = AF_INET,
		.ai_socktype = SOCK_STREAM
	};
	const char * service = zctx->tls ? TLS_PORTSTR : NON_TLS_PORTSTR;
	int err = getaddrinfo(zctx->host, service, &hint, &res);
	if (err) {
		switch(err) {
		case DNS_EAI_SYSTEM:
			printk("DNS_EAI_SYSTEM ERR: Is wifi connected?\n");
			break;
		default:
			// Look for enum with EAI_* in include/zephyr/net/dns_resolve.h
			printk("ERR: DNS fail %d\n", err);
		}
	} else if (!res || !(res->ai_addr) || (res->ai_family != AF_INET)) {
		// This shouldn't happen, but check anyway because null pointer
		// dereference hard faults are no fun.
		printk("ERR: DNS result struct was damaged\n");
	} else {
		// At this point, we can trust that res and res->ai_addr are not NULL
		// and that the result is an IPv4 address.

		// Copy IPv4 address from DNS lookup (src) to broker struct (dst)
		//
		// CAUTION! This uses weird pointer casting because that's how the
		// socket API expects you to handle the possibility that a DNS lookup
		// can resolve to either or both of IPv4 and IPv6 addresses.
		//
		// CAUTION: This ignores the possibility of more than one IP address
		// and just uses the address from the first result.
		//
		struct sockaddr_in *src = (struct sockaddr_in *)res->ai_addr;
		struct sockaddr_in *dst = (struct sockaddr_in *)broker;
		dst->sin_family = AF_INET;
		dst->sin_addr.s_addr = src->sin_addr.s_addr;
		// Set TLS or non-TLS port with network byte order conversion function
		dst->sin_port = htons(zctx->tls ? TLS_PORT : NON_TLS_PORT);

		// Debug print the DNS lookup result
		char ip_str[INET_ADDRSTRLEN];  // max length IPv4 address string
		net_addr_ntop(AF_INET, &dst->sin_addr, ip_str, sizeof(ip_str));
		printk("DNS IPv4 result: %s\n", ip_str);
	}
	// IMPORTANT: always free getaddrinfo() result to avoid memory leak
	freeaddrinfo(res);
	return err;
}
```

## src/zq3_lvgl.c
```c
/*
 * SPDX-FileCopyrightText: Copyright 2025 Sam Blenny
 * SPDX-License-Identifier: Apache-2.0
 *
 * LVGL Docs & Refs:
 * https://docs.zephyrproject.org/apidoc/latest/group__clock__apis.html
 * https://docs.lvgl.io/9.2/overview/event.html#add-events-to-a-widget
 * https://docs.lvgl.io/9.2/porting/indev.html#keypad-or-keyboard
 * https://docs.lvgl.io/9.2/porting/timer_handler.html
 * https://docs.lvgl.io/9.2/widgets/switch.html (toggle switch widget)
 * https://docs.lvgl.io/9.2/overview/display.html  (change bg color)
 * https://docs.lvgl.io/9.2/overview/color.html  (color constants)
 */

#include <zephyr/kernel.h>           // k_uptime_get_32()
#include <zephyr/drivers/display.h>  // display_blanking_off()
#include <lvgl.h>
#include <lvgl_input_device.h>
#include "zq3_lvgl.h"


// Hide a widget
static void hide(lv_obj_t *obj) {
	lv_obj_add_state(obj, LV_STATE_DISABLED);
	lv_obj_add_flag(obj, LV_OBJ_FLAG_HIDDEN);
}

// Show a widget
static void show(lv_obj_t *obj) {
	lv_obj_clear_state(obj, LV_STATE_DISABLED);
	lv_obj_remove_flag(obj, LV_OBJ_FLAG_HIDDEN);
}

// Initialize the GUI:
// - context struct (ctx) gets initialized with objects and values that need
//   to stay available for future reference while the GUI is in use
// - callback function pointer gets registered for keypad pressed events
//
void zq3_lvgl_init(zq3_lvgl_context *ctx, lv_event_cb_t keypad_callback) {
	const struct device *display = DEVICE_DT_GET(DT_CHOSEN(zephyr_display));
	const struct device *keypad =
		DEVICE_DT_GET(DT_COMPAT_GET_ANY_STATUS_OKAY(zephyr_lvgl_keypad_input));

	lv_init();
	lv_tick_set_cb(k_uptime_get_32);

	// Save theme colors in context
	ctx->gray_dark = lv_palette_darken(LV_PALETTE_GREY, 4);
	ctx->gray = lv_palette_darken(LV_PALETTE_GREY, 3);
	ctx->green = lv_palette_main(LV_PALETTE_GREEN);

	// Change background color (see also lv_palette_main())
	lv_obj_t *scr = lv_screen_active();
	lv_obj_set_style_bg_color(scr, ctx->gray_dark, 0);

	// Make wifi icon label
	ctx->wifi = lv_label_create(lv_screen_active());
	lv_label_set_text(ctx->wifi, LV_SYMBOL_WIFI);
	lv_obj_align(ctx->wifi, LV_ALIGN_TOP_RIGHT, -10, 5);
	lv_obj_set_style_text_color(ctx->wifi, ctx->gray, 0);

	// Make large text status label in center of screen
	// This is initially visible
	ctx->status = lv_label_create(lv_screen_active());
	lv_label_set_text(ctx->status, "Loading...");
	lv_obj_set_style_text_align(ctx->status, LV_TEXT_ALIGN_CENTER, 0);
	lv_obj_set_style_text_color(ctx->status, ctx->green, 0);
	lv_obj_center(ctx->status);

	// Make toggle switch widget (gets added to keypad group later)
	// This is initially hidden
	ctx->toggle = lv_switch_create(lv_screen_active());
	lv_obj_set_size(ctx->toggle, 120, 60);
	lv_obj_center(ctx->toggle);
	hide(ctx->toggle);

	// Set up input group so keypad press events go to the active screen. This
	// arrangement (vs. putting pressed event on the switch) lets the main
	// event loop consider both keypad presses and received MQTT messages to
	// decide what the toggle switch's CHECKED state should be. For this to
	// work, the devicetree config must provide a keypad with physical buttons
	// mapped to navigation keys such as LV_KEY_LEFT, LV_KEY_RIGHT, and
	// LV_KEY_ENTER. Minimum is LV_KEY_ENTER.
	lv_obj_t *screen = lv_screen_active();
	ctx->grp = lv_group_create();
	lv_group_add_obj(ctx->grp, screen);
	lv_indev_set_group(lvgl_input_get_indev(keypad), ctx->grp);
	lv_obj_add_event_cb(screen, keypad_callback, LV_EVENT_PRESSED, NULL);

	display_blanking_off(display);
}

// Show a status message in the center of the screen. This is meant for errors
// and network connection status indications. So, showing a message will hide
// the big toggle switch.
void zq3_lvgl_show_message(zq3_lvgl_context *ctx, const char *msg) {
	hide(ctx->toggle);
	show(ctx->status);
	lv_label_set_text(ctx->status, msg);
	lv_obj_set_style_text_align(ctx->status, LV_TEXT_ALIGN_CENTER, 0);
}

// Show the big toggle switch. This means MQTT is connected and subscribed
void zq3_lvgl_show_toggle(zq3_lvgl_context *ctx) {
	hide(ctx->status);
	show(ctx->toggle);
}

// Change the toggle switch state: checked==true means on, false means off
void zq3_lvgl_set_toggle(zq3_lvgl_context *ctx, bool checked) {
	if (checked) {
		lv_obj_add_state(ctx->toggle, LV_STATE_CHECKED);
	} else {
		lv_obj_clear_state(ctx->toggle, LV_STATE_CHECKED);
	}
}

// Update wifi statusbar icon color: up==true means green, false means gray
void zq3_lvgl_wifi_status(zq3_lvgl_context *ctx, bool up) {
	lv_color_t color = up ? ctx->green : ctx->gray;
	lv_obj_set_style_text_color(ctx->wifi, color, 0);
}

// The main event loop must call this frequently so LVGL can update the screen
uint32_t zq3_lvgl_timer_handler() {
	return lv_timer_handler();
}
```

## src/zq3_lvgl.h
```c
/*
 * SPDX-FileCopyrightText: Copyright 2025 Sam Blenny
 * SPDX-License-Identifier: Apache-2.0
 */
#ifndef ZQ3_LVGL_H
#define ZQ3_LVGL_H

#include <lvgl.h>


typedef struct {
	lv_color_t gray_dark;
	lv_color_t gray;
	lv_color_t green;
	lv_obj_t *wifi;        // status bar wifi icon
	lv_obj_t *status;      // large status label in center of screen
	lv_obj_t *toggle;      // toggle switch widget
	lv_group_t *grp;       // keypad input group
} zq3_lvgl_context;

void zq3_lvgl_init(zq3_lvgl_context *ctx, lv_event_cb_t keypad_callback);

void zq3_lvgl_show_message(zq3_lvgl_context *ctx, const char *msg);

void zq3_lvgl_show_toggle(zq3_lvgl_context *ctx);

void zq3_lvgl_set_toggle(zq3_lvgl_context *ctx, bool checked);

void zq3_lvgl_wifi_status(zq3_lvgl_context *ctx, bool up);

uint32_t zq3_lvgl_timer_handler();


#endif /* ZQ3_LVGL_H */
```

## src/zq3_mqtt.c
```c
/*
 * SPDX-FileCopyrightText: Copyright 2025 Sam Blenny
 * SPDX-License-Identifier: Apache-2.0
 *
 * AIO + MQTT Docs & Refs:
 * https://io.adafruit.com/api/docs/mqtt.html#adafruit-io-mqtt-api
 * https://docs.zephyrproject.org/latest/connectivity/networking/api/mqtt.html
 * https://docs.zephyrproject.org/latest/doxygen/html/structmqtt__evt.html
 * https://docs.zephyrproject.org/latest/doxygen/html/group__mqtt__socket.html
 * https://docs.zephyrproject.org/apidoc/latest/structsockaddr.html
 * https://docs.zephyrproject.org/latest/connectivity/networking/api/sockets.html#secure-sockets-interface
 * https://github.com/zephyrproject-rtos/zephyr/blob/main/include/zephyr/net/socket.h
 *
 * Adafruit IO MQTT Settings:
 * host:port: io.adafruit.com:8883
 */

#include <zephyr/kernel.h>
#include <zephyr/net/mqtt.h>
#include "zq3.h"
#include "zq3_dns.h"


// Once MQTT connection is up, event loop calls this to start subscription.
// This is hardcoded to subscribe to the one topic specified in zq3_context.
// Related docs:
// - https://docs.zephyrproject.org/latest/doxygen/html/structmqtt__subscription__list.html
// - https://docs.zephyrproject.org/latest/doxygen/html/structmqtt__topic.html
// - https://docs.zephyrproject.org/latest/doxygen/html/structmqtt__utf8.html
//
int zq3_mqtt_subscribe(zq3_context *zctx, struct mqtt_client *mctx) {
	if (zctx->state < CONNACK) {
		printk("ERR: can't subscribe, mqtt not connected.\n");
		return 1;
	}
	// This is using a C99 feature called a compound literals to initialize a
	// nested struct.
	struct mqtt_topic topic = {
		.topic = (struct mqtt_utf8){
			.utf8 = (uint8_t *)zctx->topic,
			.size = strlen(zctx->topic)
		},
		.qos = MQTT_QOS_0_AT_MOST_ONCE
	};
	struct mqtt_subscription_list list = {
		.list = &topic,
		.list_count = 1,
		.message_id = 1
	};
	// Send the subscription request
	int err = mqtt_subscribe(mctx, &list);
	printk("mqtt_subscribe() = %d\n", err);
	if(err) {
		// https://docs.zephyrproject.org/apidoc/latest/errno_8h.html
		switch(-err) {
		default:
			printk("ERR: mqtt_subscribe() = %d\n", err);
		}
		return err;
	}
	return 0;
}


// Publish new toggle switch state to the topic.
// Related docs:
// - https://docs.zephyrproject.org/latest/doxygen/html/structmqtt__publish__param.html
// - https://docs.zephyrproject.org/latest/doxygen/html/structmqtt__publish__message.html
// - https://docs.zephyrproject.org/latest/doxygen/html/structmqtt__topic.html
// - https://docs.zephyrproject.org/latest/doxygen/html/structmqtt__utf8.html
// - https://docs.zephyrproject.org/latest/doxygen/html/structmqtt__binstr.html
//
int
zq3_mqtt_publish(zq3_context *zctx, struct mqtt_client *mctx, bool toggle)
{
	char * state = toggle ? "1" : "0";
	// Build a C99 compound literal representing the message to be published
	const struct mqtt_publish_param param = {
		.message = (struct mqtt_publish_message){
			.topic = (struct mqtt_topic){
				.topic = (struct mqtt_utf8){
					.utf8 = (uint8_t *)zctx->topic,
					.size = strlen(zctx->topic),
				},
				.qos = MQTT_QOS_0_AT_MOST_ONCE,
			},
			.payload = (struct mqtt_binstr){
				.data = (uint8_t *)state,
				.len = strlen(state),
			},
		},
		.message_id = 0,
		.dup_flag = 0,
		.retain_flag = 0,
	};
	// Publish it
	int err = mqtt_publish(mctx, &param);
	if (err) {
		switch(err) {
		default:
			printk("ERR: mqtt_publish() = %d\n", err);
		}
	}
	return err;
}


// Connect to MQTT broker
int zq3_mqtt_connect(zq3_context *zctx, struct mqtt_client *mctx) {
	if (!zctx->mqtt_ok) {
		printk("ERR: MQTT broker not configured\n");
		return 1;
	}
	if (zctx->state < WIFI_UP) {
		printk("ERR: Wifi not connected\n");
		return 2;
	}
	if (mctx->broker == NULL) {
		printk("ERR: MQTT context's broker struct is null\n");
		return 3;
	}

	// Use DNS to resolve hostname to IPv4 IP (IPv6 not supported)
	int err = zq3_dns_resolve(zctx, (struct sockaddr_storage *)mctx->broker);
	if (err) {
		return err;
	}

	err = mqtt_connect(mctx);
	if(err) {
		// https://docs.zephyrproject.org/apidoc/latest/errno_8h.html
		switch(-err) {
		case EISCONN:
			printk("ERR: Socket already connected\n");
			break;
		case EAFNOSUPPORT:
			printk("ERR: Addr family not supported\n");
			break;
		case ECONNREFUSED:
			printk("ERR: Connection refused\n");
			break;
		case ETIMEDOUT:
			printk("ERR: Connection timed out\n");
			break;
		default:
			printk("ERR: %d\n", err);
		}
		if (zctx->state >= CONNWAIT) {
			zctx->state = MQTT_ERR;
		}
		return err;
	}
	zctx->fds[0].fd = mctx->transport.tcp.sock;
	zctx->fds[0].events = ZSOCK_POLLIN;
	return 0;
}


// Disconnect from MQTT broker
int zq3_mqtt_disconnect(struct mqtt_client *mctx) {
	int err = mqtt_disconnect(mctx);
	if(err) {
		// https://docs.zephyrproject.org/apidoc/latest/errno_8h.html
		switch(-err) {
		case ENOTCONN:
			printk("ERR: Socket was not connected\n");
			break;
		default:
			printk("ERR: %d\n", err);
		}
		return err;
	}
	return 0;
}
```

## src/zq3_mqtt.h
```c
/*
 * SPDX-FileCopyrightText: Copyright 2025 Sam Blenny
 * SPDX-License-Identifier: Apache-2.0
 */
#ifndef ZQ3_MQTT_H
#define ZQ3_MQTT_H

#include <zephyr/net/mqtt.h>  /* struct mqtt_client */
#include "zq3.h"              /* zq3_context */

int zq3_mqtt_subscribe(zq3_context *zctx, struct mqtt_client *mctx);

int zq3_mqtt_publish_get(zq3_context *zctx, struct mqtt_client *mctx);

int zq3_mqtt_publish(zq3_context *zctx, struct mqtt_client *mctx, bool toggle);

int zq3_mqtt_connect(zq3_context *zctx, struct mqtt_client *mctx);

int zq3_mqtt_disconnect(struct mqtt_client *mctx);

#endif /* ZQ3_MQTT_H */
```

## src/zq3_url.c
```c
/*
 * SPDX-FileCopyrightText: Copyright 2025 Sam Blenny
 * SPDX-License-Identifier: Apache-2.0
 */

#include "zq3.h"


// Debug print the config resulting from parsing the MQTT URL
void zq3_url_print_conf(zq3_context *zctx) {
	printk(
		"MQTT Broker Config:\n"
		"  user:  '%s'\n"
		"  pass:  '%s'\n"
		"  host:  '%s'\n"
		"  topic: '%s'\n"
		"  tls:   %s\n"
		"  valid: %s\n",
		zctx->user, zctx->pass, zctx->host, zctx->topic,
		zctx->tls ? "true" : "false", zctx->valid ? "true" : "false"
	);
}

// Parse an MQTT broker url into fields of the zq3_context struct
// Examples of expected url format (TLS and non-TLS):
//   mqtts://Blinka:password@io.adafruit.com/Blinka/feeds/test
//   mqtt://:@192.168.0.50/test
//
int zq3_url_parse(zq3_context *zctx, const char *url) {
	// Clear config struct and begin normal parsing
	memset(zctx->user, 0, sizeof(zctx->user));
	memset(zctx->pass, 0, sizeof(zctx->pass));
	memset(zctx->host, 0, sizeof(zctx->host));
	memset(zctx->topic, 0, sizeof(zctx->topic));
	zctx->tls = false;
	zctx->valid = false;

	const char *cursor = url;

	// Parse URL scheme prefix (should be "mqtt://" or "mqtts://")
	char *tls_scheme = "mqtts://";
	char *nontls_scheme = "mqtt://";
	if (strncmp(url, tls_scheme, strlen(tls_scheme)) == 0) {
		// Scheme = MQTT with TLS
		cursor += strlen(tls_scheme);
		zctx->tls = true;
	} else if (strncmp(url, nontls_scheme, strlen(nontls_scheme)) == 0) {
		// Scheme = unencrypted MQTT
		cursor += strlen(nontls_scheme);
		zctx->tls = false;
	} else {
		printk("ERROR: expected mqtt:// or mqtts://\n");
		return 3;
	}

	// Parse username (whatever is between end of scheme and the next ':')
	char *delim = strchr((char *)cursor, ':');
	int len = delim - cursor;
	if (!delim || len < 0) {
		printk("ERR: missing ':' after username\n");
		return 4;
	} else if (len >= sizeof(zctx->user)) {
		printk("ERR: username too long\n");
		return 5;
	} else {
		// Copy username string (relies on len < sizeof(...))
		memcpy(zctx->user, cursor, len);
		cursor = delim + 1;
	}

	// Parse password (whatever is between ':' and '@')
	delim = strchr((char *)cursor, '@');
	len = delim - cursor;
	if (!delim || len < 0) {
		printk("ERR: missing '@' after password\n");
		return 6;
	} else if (len >= sizeof(zctx->pass)) {
		printk("ERR: password too long\n");
		return 7;
	} else {
		// Copy password string (relies on len < sizeof(...))
		memcpy(zctx->pass, cursor, len);
		cursor = delim + 1;
	}

	// Parse host (whatever is between '@' and '/')
	delim = strchr((char *)cursor, '/');
	len = delim - cursor;
	if (!delim) {
		printk("ERR: missing '/' after hostname\n");
		return 8;
	} else if (len < 1) {
		printk("ERR: hostname can't be blank\n");
		return 9;
	} else if (len >= sizeof(zctx->host)) {
		printk("ERR: hostname too long\n");
		return 10;
	} else {
		// Copy hostname string (relies on len < sizeof(...))
		memcpy(zctx->host, cursor, len);
		cursor = delim + 1;
	}

	// Parse topic (whatever is after '/')
	len = strlen(cursor);
	if (len <= 0) {
		printk("ERR: topic can't be blank\n");
		return 11;
	} else if (len >= sizeof(zctx->topic)) {
		printk("ERR: topic too long\n");
		return 12;
	} else {
		// Copy topic string (relies on len < sizeof(...))
		memcpy(zctx->topic, cursor, len);
	}

	return 0;
}
```

## src/zq3_wifi.c
```c
/*
 * SPDX-FileCopyrightText: Copyright 2025 Sam Blenny
 * SPDX-License-Identifier: Apache-2.0
 *
 * Functions for managing the Wifi connection
 *
 * Docs & Refs:
 * - https://github.com/zephyrproject-rtos/zephyr/blob/main/subsys/net/l2/wifi/wifi_shell.c
 * - https://docs.zephyrproject.org/latest/connectivity/networking/api/net_mgmt.html
 * - https://docs.zephyrproject.org/latest/doxygen/html/group__net__mgmt.html
 * - https://docs.zephyrproject.org/latest/doxygen/html/group__wifi__mgmt.html
 * - https://docs.zephyrproject.org/apidoc/latest/group__net__if.html
 * - https://github.com/zephyrproject-rtos/zephyr/blob/main/include/zephyr/net/wifi.h
 */

#include <zephyr/net/net_mgmt.h>   /* net_mgmt() */
#include <zephyr/net/net_if.h>     /* net_if_get_wifi_sta() */
#include <zephyr/net/wifi.h>       /* WIFI_SECURITY_TYPE_WPA_PSK, ... */
#include <zephyr/net/wifi_mgmt.h>  /* NET_REQUEST_WIFI_CONNECT, ... */


// Connect to the specified Wifi AP using WPA2-PSK
int zq3_wifi_connect(const char *ssid, const char *psk) {
	if (ssid == NULL || strlen(ssid) == 0) {
		printk("ERR: Wifi connect: SSID not specified\n");
		return -EINVAL;
	}
	if (psk == NULL || strlen(psk) == 0) {
		printk("ERR: Wifi connect: PSK not specified\n");
		return -EINVAL;
	}
	if (strlen(ssid) > WIFI_SSID_MAX_LEN) {
		printk("ERR: Wifi connect: SSID is too long\n");
		return -EINVAL;
	}
	// References for wifi_connect_req_params:
	// - zephyr/include/zephyr/net/wifi.h        (enums)
	// - zephyr/include/zephyr/net/wifi_mgmt.h   (struct def)
	// - zephyr/samples/net/l2/wifi/wifi_shell.c (default values)
	struct wifi_connect_req_params params = {
		.ssid = ssid,
		.ssid_length = strlen(ssid),
		.psk = psk,
		.psk_length = strlen(psk),
		.band = WIFI_FREQ_BAND_2_4_GHZ,         // enum wifi_frequency_bands
		.channel = WIFI_CHANNEL_ANY,
		.security = WIFI_SECURITY_TYPE_PSK,     // enum wifi_security_type
		.mfp = WIFI_MFP_OPTIONAL,
		.eap_ver = 1,
		.ignore_broadcast_ssid = 0,
		.bandwidth = WIFI_FREQ_BANDWIDTH_20MHZ, // wifi_frequency_bandwidths
		.verify_peer_cert = false,
	};
	struct net_if *i = net_if_get_wifi_sta();
	int err = net_mgmt(NET_REQUEST_WIFI_CONNECT, i, &params, sizeof(params));
	if (err) {
		printk("ERR: Wifi connect: net_mgmt() = %d\n", err);
	} else {
		printk("[Wifi CONNECT requested]\n");
	}
	return err;
}

// Disconnect from Wifi
int zq3_wifi_disconnect() {
	struct net_if *i = net_if_get_wifi_sta();
	int err = net_mgmt(NET_REQUEST_WIFI_DISCONNECT, i, NULL, 0);
	switch (err) {
	case 0:
		printk("[Wifi DISCONNECT requested]\n");
		return 0;
	case -EALREADY:
		printk("Wifi disconnect: already disconnected\n");
		return 0;
	default:
		printk("ERR: Wifi disconnect: net_mgmt() = %d\n", err);
		return err;
	}
}
```

## src/zq3_wifi.h
```c
/*
 * SPDX-FileCopyrightText: Copyright 2025 Sam Blenny
 * SPDX-License-Identifier: Apache-2.0
 *
 */
#ifndef ZQ3_WIFI_H
#define ZQ3_WIFI_H


int zq3_wifi_connect(const char *ssid, const char *psk);

int zq3_wifi_disconnect();


#endif /* ZQ3_WIFI_H */
```
