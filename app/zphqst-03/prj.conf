## prj.conf
```kconfig
# SPDX-FileCopyrightText: Copyright 2025 Sam Blenny
# SPDX-License-Identifier: Apache-2.0

CONFIG_EARLY_CONSOLE=y
CONFIG_LOG_MODE_IMMEDIATE=y
CONFIG_GPIO=y
CONFIG_INPUT=y

# For tuning these, you can use the `kernel heap`, `kernel thread list`, and
# `net mem` shell commands to monitor memory usage. But, you will need to
# enable some extra config options (see below).
CONFIG_HEAP_MEM_POOL_SIZE=51200
CONFIG_MAIN_STACK_SIZE=5200
CONFIG_SHELL_STACK_SIZE=4096
CONFIG_SYSTEM_WORKQUEUE_STACK_SIZE=4096

# LVGL
CONFIG_LV_Z_MEM_POOL_SIZE=16384
CONFIG_LV_Z_VDB_ALIGN=32

# Support for saving settings in flash at runtime (see shell config below)
CONFIG_FLASH=y
CONFIG_FLASH_MAP=y
CONFIG_NVS=y
CONFIG_SETTINGS=y
CONFIG_SETTINGS_NVS=y
CONFIG_SETTINGS_RUNTIME=y
# For default storage partition at 0x3b0000 of size 0x30000
CONFIG_SETTINGS_NVS_SECTOR_COUNT=48

# Enable networking with wifi
CONFIG_NETWORKING=y
CONFIG_POSIX_API=y
CONFIG_NET_L2_ETHERNET=y
CONFIG_WIFI=y
CONFIG_ESP32_WIFI_STA_AUTO_DHCPV4=y

# Networking debug stuff (watch packets & protocol progress)
#CONFIG_NET_TCP_LOG_LEVEL_DBG=y
CONFIG_LOG_MODE_MINIMAL=y

# Something about the original CONFIG_NET_* settings I was using caused my wifi
# router and/or Debian MQTT test server to drop packets. I'm not sure why.
# During testing I had to reset the router and Debian wifi interface many
# times. After experimenting with different CONFIG_NET_* settings, I ended up
# with this config which seems to behave much better. Possible that the net
# stack was glitching due to memory allocation errors.
#
# For net stack config options, see:
# https://docs.zephyrproject.org/latest/connectivity/networking/net_config_guide.html
# - Ethernet maximum transmission unit (MTU) is 1500 bytes
# - For 2 full frame RX at CONFIG_NET_BUF_DATA_SIZE=128 (the default), then
#   net packet RX count is 2. Net buffer RX count is 2*1500/128 = 23.4 which
#   rounds up to 24. But, using TCP needs more for queueing packets.

# TX capacity: 6 small-ish packets
CONFIG_NET_PKT_TX_COUNT=6
CONFIG_NET_BUF_TX_COUNT=32
CONFIG_NET_TX_STACK_SIZE=4096
# RX capacity: 6 small-ish packets
CONFIG_NET_PKT_RX_COUNT=6
CONFIG_NET_BUF_RX_COUNT=32
CONFIG_NET_RX_STACK_SIZE=4096
# 1 context = 1 BSD socket listener or sender
CONFIG_NET_MAX_CONTEXTS=10
CONFIG_NET_MGMT_EVENT_QUEUE_TIMEOUT=5000
CONFIG_NET_MGMT_EVENT_QUEUE_SIZE=16

CONFIG_NET_IPV4=y
CONFIG_NET_IPV6=n
CONFIG_NET_DHCPV4=y
CONFIG_NET_TCP=y
CONFIG_NET_UDP=y
CONFIG_NET_LOG=y

CONFIG_DNS_RESOLVER=y
CONFIG_MQTT_LIB=y
CONFIG_MQTT_LIB_TLS=y

CONFIG_DISPLAY=y
CONFIG_DISPLAY_LOG_LEVEL_ERR=y

CONFIG_LVGL=y
CONFIG_LV_USE_LOG=y
CONFIG_LV_USE_LABEL=y
CONFIG_LV_FONT_DEFAULT_MONTSERRAT_14=n
CONFIG_LV_FONT_DEFAULT_MONTSERRAT_18=y
CONFIG_LV_USE_ANIMIMG=n
CONFIG_LV_USE_CALENDAR=n

CONFIG_SHELL=y
CONFIG_SHELL_HISTORY=y
CONFIG_SETTINGS_SHELL=y
CONFIG_FLASH_MAP_SHELL=y
CONFIG_FLASH_SHELL=y
CONFIG_FLASH_SHELL_TEST_COMMANDS=y

CONFIG_NET_SHELL=n
CONFIG_NET_SHELL_SHOW_DISABLED_COMMANDS=n
CONFIG_SHELL_STATS=n
CONFIG_SHELL_CMDS=n
CONFIG_DATE_SHELL=n
CONFIG_DEVICE_SHELL=n
CONFIG_DEVMEM_SHELL=n
CONFIG_KERNEL_SHELL=n

# These config options are useful for tuning stack and heap settings with
# the `kernel heap`, `kernel thread list`, and `net mem` shell commands
#CONFIG_NET_SHELL=y
#CONFIG_KERNEL_SHELL=y
#CONFIG_STACK_USAGE=y
#CONFIG_THREAD_ANALYZER=y
#CONFIG_THREAD_NAME=y
#CONFIG_THREAD_RUNTIME_STATS=y
#CONFIG_SCHED_THREAD_USAGE=y
#CONFIG_SYS_HEAP_RUNTIME_STATS=y
#CONFIG_NET_STATISTICS=y
#CONFIG_NET_BUF_POOL_USAGE=y
#CONFIG_NET_PKT_ALLOC_STATS=y
#CONFIG_NET_SHELL_STATISTICS_SUPPORTED=y
```

## src/zq3_dns.c
```c
/*
 * SPDX-FileCopyrightText: Copyright 2025 Sam Blenny
 * SPDX-License-Identifier: Apache-2.0
 *
 * DNS & Socket Docs & Refs:
 * https://docs.zephyrproject.org/apidoc/latest/group__bsd__sockets.html
 * https://docs.zephyrproject.org/apidoc/latest/netdb_8h.html (getaddrinfo / freeaddrinfo)
 * https://github.com/zephyrproject-rtos/zephyr/blob/main/include/zephyr/net/dns_resolve.h
 * https://docs.zephyrproject.org/apidoc/latest/group__ip__4__6.html (net_addr_ntop)
 */

#include <zephyr/net/socket.h>
#include "zq3.h"


#define TLS_PORTSTR     ("8883")
#define TLS_PORT        (8883)
#define NON_TLS_PORTSTR ("1883")
#define NON_TLS_PORT    (1883)

// Resolve hostname to IPv4 IP (IPv6 not supported)
// This requires CONFIG_POSIX_API=y and CONFIG_NET_SOCKETS_POSIX_NAMES=y.
//
int zq3_dns_resolve(zq3_context *zctx, struct sockaddr_storage *broker) {
	if (zctx == NULL || broker == NULL) {
		return 1;
	}
	struct addrinfo *res = NULL;
	const struct addrinfo hint = {
		.ai_family = AF_INET,
		.ai_socktype = SOCK_STREAM
	};
	printk("Attempting DNS lookup for '%s'\n", zctx->host);
	const char * service = zctx->tls ? TLS_PORTSTR : NON_TLS_PORTSTR;
	int err = getaddrinfo(zctx->host, service, &hint, &res);
	if (err) {
		switch(err) {
		case DNS_EAI_SYSTEM:
			printk("ERR: DNS_EAI_SYSTEM: Is wifi connected?\n");
			break;
		case DNS_EAI_CANCELED:
			// This happened to me while testing on a wifi router bridged to
			// a private Ethernet LAN with no gateway and no DNS server. In
			// that case, the DNS resolver still works fine for IP address
			// strings, but it can't do hostnames. Solution: use wifi network
			// that provides access to gateway router and DNS server.
			printk("ERR: DNS_EAI_SYSTEM: Did DHCP give you a DNS server?\n");
			break;
		default:
			// Look for enum with EAI_* in include/zephyr/net/dns_resolve.h
			printk("ERR: DNS fail %d\n", err);
		}
	} else if (!res || !(res->ai_addr) || (res->ai_family != AF_INET)) {
		// This shouldn't happen, but check anyway because null pointer
		// dereference hard faults are no fun.
		printk("ERR: DNS result struct was damaged\n");
	} else {
		// At this point, we can trust that res and res->ai_addr are not NULL
		// and that the result is an IPv4 address.

		// Copy IPv4 address from DNS lookup (src) to broker struct (dst)
		//
		// CAUTION! This uses weird pointer casting because that's how the
		// socket API expects you to handle the possibility that a DNS lookup
		// can resolve to either or both of IPv4 and IPv6 addresses.
		//
		// CAUTION: This ignores the possibility of more than one IP address
		// and just uses the address from the first result.
		//
		struct sockaddr_in *src = (struct sockaddr_in *)res->ai_addr;
		struct sockaddr_in *dst = (struct sockaddr_in *)broker;
		dst->sin_family = AF_INET;
		dst->sin_addr.s_addr = src->sin_addr.s_addr;
		// Set TLS or non-TLS port with network byte order conversion function
		dst->sin_port = htons(zctx->tls ? TLS_PORT : NON_TLS_PORT);

		// Debug print the DNS lookup result
		char ip_str[INET_ADDRSTRLEN];  // max length IPv4 address string
		net_addr_ntop(AF_INET, &dst->sin_addr, ip_str, sizeof(ip_str));
		printk("DNS IPv4 result: %s\n", ip_str);
	}
	// IMPORTANT: always free getaddrinfo() result to avoid memory leak
	freeaddrinfo(res);
	return err;
}
```

## src/zq3_dns.h
```c
/*
 * SPDX-FileCopyrightText: Copyright 2025 Sam Blenny
 * SPDX-License-Identifier: Apache-2.0
 */
#ifndef ZQ3_DNS_H
#define ZQ3_DNS_H

int zq3_dns_resolve(zq3_context *zctx, struct sockaddr_storage *broker);

#endif /* ZQ3_DNS_H */
```

## src/zq3_mqtt.h
```c
/*
 * SPDX-FileCopyrightText: Copyright 2025 Sam Blenny
 * SPDX-License-Identifier: Apache-2.0
 */
#ifndef ZQ3_MQTT_H
#define ZQ3_MQTT_H

#include <zephyr/net/mqtt.h>  /* struct mqtt_client */
#include "zq3.h"              /* zq3_context */

int zq3_mqtt_subscribe(zq3_context *zctx, struct mqtt_client *mctx);

int zq3_mqtt_publish(zq3_context *zctx, struct mqtt_client *mctx, bool toggle);

int zq3_mqtt_connect(zq3_context *zctx, struct mqtt_client *mctx);

int zq3_mqtt_disconnect(struct mqtt_client *mctx);

#endif /* ZQ3_MQTT_H */
```
