## prj.conf
```kconfig
# SPDX-FileCopyrightText: Copyright 2025 Sam Blenny
# SPDX-License-Identifier: Apache-2.0

CONFIG_EARLY_CONSOLE=y
CONFIG_LOG_MODE_IMMEDIATE=y
CONFIG_LOG_MODE_MINIMAL=y
CONFIG_GPIO=y
CONFIG_INPUT=y

# For tuning these, you can use the `kernel heap`, `kernel thread list`, and
# `net mem` shell commands to monitor memory usage. But, you will need to
# enable some extra config options (see below).
CONFIG_HEAP_MEM_POOL_SIZE=51200
CONFIG_MAIN_STACK_SIZE=5200
CONFIG_SHELL_STACK_SIZE=4096
CONFIG_SYSTEM_WORKQUEUE_STACK_SIZE=4096

# LVGL memory config
CONFIG_LV_Z_MEM_POOL_SIZE=16384
CONFIG_LV_Z_VDB_ALIGN=32

# Support for saving settings in flash at runtime (see shell config below)
CONFIG_FLASH=y
CONFIG_FLASH_MAP=y
CONFIG_NVS=y
CONFIG_SETTINGS=y
CONFIG_SETTINGS_NVS=y
CONFIG_SETTINGS_RUNTIME=y
# For default storage partition at 0x3b0000 of size 0x30000
CONFIG_SETTINGS_NVS_SECTOR_COUNT=48

# Enable networking with wifi
# I had intermittent problems connecting to one of my APs with the default
# 20dBm TX power. Reducing power to 10 dBm seems much more reliable.
CONFIG_NETWORKING=y
CONFIG_POSIX_API=y
CONFIG_NET_L2_ETHERNET=y
CONFIG_WIFI=y
CONFIG_ESP32_WIFI_STA_AUTO_DHCPV4=y
CONFIG_ESP32_PHY_MAX_TX_POWER=10

# TLSv1.2 with PEM certificates
CONFIG_MBEDTLS=y
CONFIG_MBEDTLS_ENABLE_HEAP=y
CONFIG_MBEDTLS_HEAP_SIZE=32768
CONFIG_NET_SOCKETS_SOCKOPT_TLS=y
CONFIG_MBEDTLS_PEM_CERTIFICATE_FORMAT=y
CONFIG_MBEDTLS_ASN1_PARSE_C=y
CONFIG_MBEDTLS_SERVER_NAME_INDICATION=y
CONFIG_MBEDTLS_ENTROPY_C=y
CONFIG_MBEDTLS_ENTROPY_POLL_ZEPHYR=y

# Cipher suite stuff for TLSv1.2 with ECDHE-RSA-AES256-GCM-SHA384
CONFIG_MBEDTLS_CIPHER_GCM_ENABLED=y
CONFIG_MBEDTLS_SHA384=y
CONFIG_MBEDTLS_ECP_C=y
CONFIG_MBEDTLS_ECP_DP_SECP256R1_ENABLED=y
CONFIG_MBEDTLS_ECP_DP_SECP384R1_ENABLED=y
CONFIG_MBEDTLS_ECP_DP_CURVE25519_ENABLED=y
CONFIG_MBEDTLS_ECDH_C=y
CONFIG_MBEDTLS_KEY_EXCHANGE_ECDHE_RSA_ENABLED=y

# This is needed for the TLS handshake with io.adafruit.com. Without it,
# the mbedtls debug log shows a fragmentation error:
#   TLS handshake fragmentation not supported
CONFIG_MBEDTLS_SSL_MAX_CONTENT_LEN=4096

# Networking debug stuff (watch packets & protocol progress)
#CONFIG_NET_TCP_LOG_LEVEL_DBG=y
#CONFIG_WIFI_LOG_LEVEL_DBG=y
#CONFIG_WIFI_LOG_LEVEL=4
#CONFIG_NET_SOCKETS_LOG_LEVEL_DBG=y

# For debugging mysterious mbedtls error: "TLS handshake error: -0x7080"
#CONFIG_MBEDTLS_LOG_LEVEL_WRN=y
#CONFIG_MBEDTLS_LOG_LEVEL_DBG=y
#CONFIG_MBEDTLS_DEBUG=y
CONFIG_MBEDTLS_MEMORY_DEBUG=y

# Something about the original CONFIG_NET_* settings I was using caused my wifi
# router and/or Debian MQTT test server to drop packets. I'm not sure why.
# During testing I had to reset the router and Debian wifi interface many
# times. After experimenting with different CONFIG_NET_* settings, I ended up
# with this config which seems to behave much better. Possible that the net
# stack was glitching due to memory allocation errors.
#
# For net stack config options, see:
# https://docs.zephyrproject.org/latest/connectivity/networking/net_config_guide.html
# - Ethernet maximum transmission unit (MTU) is 1500 bytes
# - For 2 full frame RX at CONFIG_NET_BUF_DATA_SIZE=128 (the default), then
#   net packet RX count is 2. Net buffer RX count is 2*1500/128 = 23.4 which
#   rounds up to 24. But, using TCP needs more for queueing packets.

# TX capacity: 6 small-ish packets
CONFIG_NET_PKT_TX_COUNT=6
CONFIG_NET_BUF_TX_COUNT=64
CONFIG_NET_TX_STACK_SIZE=8192
# RX capacity: 6 small-ish packets
CONFIG_NET_PKT_RX_COUNT=6
CONFIG_NET_BUF_RX_COUNT=64
CONFIG_NET_RX_STACK_SIZE=8192
# 1 context = 1 BSD socket listener or sender
CONFIG_NET_MAX_CONTEXTS=10
CONFIG_NET_MGMT_EVENT_QUEUE_TIMEOUT=5000
CONFIG_NET_MGMT_EVENT_QUEUE_SIZE=16

CONFIG_NET_IPV4=y
CONFIG_NET_IPV6=n
CONFIG_NET_DHCPV4=y
CONFIG_NET_TCP=y
CONFIG_NET_UDP=y
CONFIG_NET_LOG=y

CONFIG_DNS_RESOLVER=y
CONFIG_MQTT_LIB=y
CONFIG_MQTT_LIB_TLS=y

CONFIG_DISPLAY=y
CONFIG_DISPLAY_LOG_LEVEL_ERR=y

CONFIG_LVGL=y
CONFIG_LV_USE_LOG=y
CONFIG_LV_USE_LABEL=y
CONFIG_LV_FONT_DEFAULT_MONTSERRAT_14=n
CONFIG_LV_FONT_DEFAULT_MONTSERRAT_18=y
CONFIG_LV_USE_ANIMIMG=n
CONFIG_LV_USE_CALENDAR=n

CONFIG_SHELL=y
CONFIG_SHELL_HISTORY=y
CONFIG_SETTINGS_SHELL=y
CONFIG_FLASH_MAP_SHELL=y
CONFIG_FLASH_SHELL=y
CONFIG_FLASH_SHELL_TEST_COMMANDS=y

CONFIG_SHELL_STATS=n
CONFIG_SHELL_CMDS=n
CONFIG_DATE_SHELL=n
CONFIG_DEVICE_SHELL=n
CONFIG_DEVMEM_SHELL=n
CONFIG_NET_SHELL_SHOW_DISABLED_COMMANDS=n
CONFIG_KERNEL_SHELL=n
CONFIG_NET_SHELL=n

# These config options are useful for tuning stack and heap settings with
# the `kernel heap`, `kernel thread list`, and `net mem` shell commands
#CONFIG_KERNEL_SHELL=y
#CONFIG_NET_SHELL=y
#CONFIG_MBEDTLS_SHELL=y
#CONFIG_STACK_USAGE=y
#CONFIG_THREAD_ANALYZER=y
#CONFIG_THREAD_NAME=y
#CONFIG_THREAD_RUNTIME_STATS=y
#CONFIG_SCHED_THREAD_USAGE=y
#CONFIG_SYS_HEAP_RUNTIME_STATS=y
#CONFIG_NET_STATISTICS=y
#CONFIG_NET_BUF_POOL_USAGE=y
#CONFIG_NET_PKT_ALLOC_STATS=y
#CONFIG_NET_SHELL_STATISTICS_SUPPORTED=y
```

## app.overlay
```dts
/*
 * SPDX-FileCopyrightText: Copyright 2025 Sam Blenny
 * SPDX-License-Identifier: Apache-2.0
 *
 * This configures a flash partition for use with the Settings API
 *
 * Related:
 * - zephyr/dts/common/espressif/partitions_0x0_amp_4M.dtsi
 */

/ {
	chosen {
		zephyr,settings-partition = &storage_partition;
	};
};

&trng0 {
	status = "okay";
};

&storage_partition {
	label = "settings";
};
```

## src/main.c
```c
/*
 * SPDX-FileCopyrightText: Copyright 2025 Sam Blenny
 * SPDX-License-Identifier: Apache-2.0
 *
 * Wifi + Network Manager Docs & Refs:
 * https://docs.zephyrproject.org/latest/doxygen/html/group__net__mgmt.html
 * https://docs.zephyrproject.org/latest/doxygen/html/structnet__mgmt__event__callback.html
 * https://github.com/zephyrproject-rtos/zephyr/blob/main/subsys/net/l2/wifi/wifi_shell.c
 */

#include <zephyr/kernel.h>
#include <zephyr/net/mqtt.h>
#include <zephyr/net/wifi_mgmt.h>     // NET_EVENT_WIFI_CONNECT_RESULT, ...
#include <zephyr/settings/settings.h>
#include <zephyr/shell/shell.h>
#include "zq3.h"
#include "zq3_mqtt.h"
#include "zq3_lvgl.h"
#include "zq3_url.h"
#include "zq3_wifi.h"


/*
* STATIC GLOBALS AND CONSTANTS
*/

// Context for wifi status, mqtt config, and mqtt status
static zq3_context ZCtx = {
	.ssid = {'\0'},
	.psk =  {'\0'},
	.mqtt_ok = false,
	.state = OFFLINE,
	.keypress = false,
	.got_0 = false,
	.got_1 = false,
	.toggle = UNKNOWN,
};

// MQTT context struct (initialized by zq3_mqtt_init())
static zq3_mqtt_context MCtx;


/*
* NETWORK EVENT HANDLERS
*/

// Handle MQTT events.
// Related docs:
// - https://docs.zephyrproject.org/latest/doxygen/html/structmqtt__evt.html
// - https://docs.zephyrproject.org/latest/doxygen/html/unionmqtt__evt__param.html
// - https://docs.zephyrproject.org/latest/doxygen/html/structmqtt__publish__param.html
// - https://docs.zephyrproject.org/latest/doxygen/html/structmqtt__publish__message.html
// - https://docs.zephyrproject.org/latest/doxygen/html/structmqtt__topic.html
// - https://docs.zephyrproject.org/latest/doxygen/html/structmqtt__binstr.html
//
static void mq_handler(struct mqtt_client *client, const struct mqtt_evt *e) {
	switch (e->type) {
	case MQTT_EVT_CONNACK:
		ZCtx.state = CONNACK;
		break;
	case MQTT_EVT_DISCONNECT:
		printk("DISCONNECT\n");
		ZCtx.state = MQTT_ERR;
		ZCtx.toggle = UNKNOWN;   // because we're no longer subscribed
		break;
	case MQTT_EVT_PUBLISH:
		// This happens when the broker informs us that somebody published a
		// message to a topic we have subscribed to. The parameter, e->param,
		// will be of type mqtt_publish_param.

		// First extract topic from the param struct and check for match
		const struct mqtt_publish_message *m = &e->param.publish.message;
		const uint8_t *topic = m->topic.topic.utf8;
		uint32_t t_len = m->topic.topic.size;
		if (t_len >= sizeof(MCtx.topic) || memcmp(topic, MCtx.topic, t_len)) {
			printk("ignoring unknown topic (len = %d)\n", t_len);
			return;
		}

		// Second, get the payload data and parse it.
		// CAUTION: You can't get the payload data from the payload struct.
		// Instead you have to call this function (see mqtt_evt_type docs).
		uint8_t buf[32] = {0};
		uint32_t payload_len = m->payload.len;
		int count = mqtt_read_publish_payload(&MCtx.client, buf, sizeof(buf));
		if (count != 1 || count != payload_len) {
			printk("ERR: unexpected payload length: %d\n", count);
			return;
		}

		// Parse payload data for expected messages: "1" or "0"
		switch((char)buf[0]) {
		case '0':
			printk("PUB GOT 0\n");
			ZCtx.got_0 = true;
			break;
		case '1':
			printk("PUB GOT 1\n");
			ZCtx.got_1 = true;
			break;
		default:
			printk("PUB GOT unknown value\n");
		}
		break;
	case MQTT_EVT_SUBACK:
		ZCtx.state = SUBACK;
		break;
	case MQTT_EVT_PINGRESP:
		// This can be useful, but it's noisy
		//printk("PINGRESP\n");
		break;
	default:
		break;
	}
}

// Handle network manager events (wifi up / wifi down)
static void net_callback(
	struct net_mgmt_event_callback *cb,
	uint32_t mgmt_event,
	struct net_if *iface
) {
	switch(mgmt_event) {
	case NET_EVENT_WIFI_CONNECT_RESULT:
		printk("NET_EVENT_WIFI_CONNECT_RESULT\n");
		ZCtx.state = WIFI_UP;
		break;
	case NET_EVENT_WIFI_DISCONNECT_RESULT:
		printk("NET_EVENT_WIFI_DISCONNECT_RESULT\n");
		ZCtx.state = WIFI_ERR;
		break;
	default:
		printk("net: unknown event\n");
	}
}


/*
* SHELL COMMANDS
*/

// Connect to Wifi
static int cmd_wifi_up(const struct shell *shell, size_t argc, char *argv[]) {
	return zq3_wifi_connect(ZCtx.ssid, ZCtx.psk);
}

// Disconnect from Wifi
static int cmd_wifi_dn(const struct shell *shell, size_t argc, char *argv[]) {
	return zq3_wifi_disconnect();
}

// Connect to MQTT broker
static int cmd_up(const struct shell *shell, size_t argc, char *argv[]) {
	int err = zq3_mqtt_connect(&MCtx);
	if (err) {
		ZCtx.state = MQTT_ERR;
		return err;
	}
	ZCtx.state = CONNWAIT;
	return 0;
}

// Disconnect from MQTT broker
static int cmd_dn(const struct shell *shell, size_t argc, char *argv[]) {
	int err = zq3_mqtt_disconnect(&MCtx);
	if (err) {
		ZCtx.state = MQTT_ERR;
		return err;
	}
	ZCtx.state = MQTT_ERR;  // CAUTION: WIFI_UP would trigger a reconnect
	return 0;
}

// Reload settings. (you can use this after `settings write ...`)
static int cmd_reload(const struct shell *shell, size_t argc, char *argv[]) {
	// Clear wifi and MQTT settings from context struct
	memset(ZCtx.ssid, 0, sizeof(ZCtx.ssid));
	memset(ZCtx.psk, 0, sizeof(ZCtx.psk));
	ZCtx.mqtt_ok = false;
	// Load saved settings
	return settings_load();
}



/*
* SETTINGS READING CALLBACKS
* To write settings to flash, use the Zephyr shell `settings` command.
* Docs:
* - https://docs.zephyrproject.org/latest/services/storage/settings/index.html
* - https://docs.zephyrproject.org/latest/doxygen/html/group__settings.html
*/

// This callback runs each time settings_load() reads a key from the NVM flash
// backend which matches the configured prefix. The API docs confusingly refer
// to this as "set" callback. The semantics seem like what I'd expect from a
// getter. But, whatever. To read the saved values of keys, this works.
//
static int
set_cb(const char *key, size_t len, settings_read_cb read_cb, void *cb_arg)
{
	char buf[256];
	if (len >= sizeof(buf)) {
		printk("setting value for key '%s' is too big: %d\n", key, len);
		return -EMSGSIZE;
	}
	int rc = read_cb(cb_arg, buf, sizeof(buf));
	if (rc < 0) {
		printk("ERR: settings read_cb(%s) = %d\n", key, rc);
		return rc;
	}
	buf[sizeof(buf)-1] = '\0';  // make sure string is null terminated
	int vlen = strlen(buf);
	if (strcmp("url", key) == 0) {
		// Parse MQTT URL and save components to context struct
		if (vlen >= ZQ3_MQTT_URL_MAX_LEN) {
			printk("ERR: setting for '%s' is too long: %d\n", key, vlen);
			return -EOVERFLOW;
		}
		int err = zq3_url_parse(&MCtx, buf);
		if (err) {
			printk("ERR settings: failed to parse url: %d\n", err);
			ZCtx.mqtt_ok = false;
			return err;
		}
		// Success
		ZCtx.mqtt_ok = true;
	} else if (strcmp("ssid", key) == 0) {
		// Save Wifi SSID to context struct
		if (vlen >= sizeof(ZCtx.ssid)) {
			printk("ERR: setting for '%s' is too long: %d\n", key, vlen);
			return -EOVERFLOW;
		}
		memset(ZCtx.ssid, 0, sizeof(ZCtx.ssid));
		memcpy(ZCtx.ssid, buf, vlen);
	} else if (strcmp("psk", key) == 0) {
		// Save Wifi passphrase to context struct
		if (vlen >= sizeof(ZCtx.psk)) {
			printk("ERR: setting for '%s' is too long: %d\n", key, vlen);
			return -EOVERFLOW;
		}
		memset(ZCtx.psk, 0, sizeof(ZCtx.psk));
		memcpy(ZCtx.psk, buf, vlen);
	}
	printk("Settings SET: '%s'\n", key);
	return 0;
}


/*
* KEYPAD BUTTON PRESS CALLBACK
*/

// Callback to handle keypad input events
static void keypad_pressed_callback(lv_event_t *event) {
	ZCtx.keypress = true;
}


/*
* STATIC CALLBACK MACROS (shell & settings)
*/

// These macros add the `aio *` shell commands for controlling the MQTT broker
// connection in the Zephyr shell over USB serial. MQTT broker config gets
// read from 'zq3/url' setting stored in NVM flash (`settings write ...`).
//
SHELL_STATIC_SUBCMD_SET_CREATE(aio_cmds,
	SHELL_CMD(wifi_up, NULL, "Wifi connect", cmd_wifi_up),
	SHELL_CMD(wifi_dn, NULL, "Wifi disconnect", cmd_wifi_dn),
	SHELL_CMD(up, NULL, "AIO MQTT broker connect", cmd_up),
	SHELL_CMD(dn, NULL, "AIO MQTT broker disconnect", cmd_dn),
	SHELL_CMD(reload, NULL, "Reload settings", cmd_reload),
	SHELL_SUBCMD_SET_END
);

// This macro configures the callbacks to be invoked by settings_load()
SETTINGS_STATIC_HANDLER_DEFINE(zq3, "zq3", NULL, set_cb, NULL, NULL);


/*
* MAIN
*/

int main(void) {
	// Inits
	struct net_mgmt_event_callback net_status;
	zq3_lvgl_context LCtx;
	zq3_lvgl_init(&LCtx, keypad_pressed_callback);
	SHELL_CMD_REGISTER(aio, &aio_cmds, "Adafruit IO MQTT commands", NULL);
	zq3_mqtt_init(&MCtx, mq_handler);
	settings_subsys_init();

	// Get settings from NVM flash using the Settings API
	printk("Loading Settings\n");
	settings_load();

	// Register to get updates about wifi connection status
	net_mgmt_init_event_callback(&net_status, net_callback,
		NET_EVENT_WIFI_CONNECT_RESULT | NET_EVENT_WIFI_DISCONNECT_RESULT);
	net_mgmt_add_event_callback(&net_status);

	// Event loop
	zq3_state prev_state = ZCtx.state;
	zq3_toggle prev_toggle = ZCtx.toggle;
	zq3_lvgl_timer_handler();
	const char *offline_message = "Press\nBOOT button\nto connect";
	zq3_lvgl_show_message(&LCtx, offline_message);
	while(1) {
		int err;
		// Update GUI when Wifi/MQTT connection state changes
		if (prev_state != ZCtx.state) {
			prev_state = ZCtx.state;
			switch(ZCtx.state) {
			case OFFLINE:
				// This happens when wifi disconnects for some reason
				printk("[OFFLINE]\n");
				zq3_lvgl_wifi_status(&LCtx, false);
				zq3_lvgl_show_message(&LCtx, offline_message);
				break;
			case WIFI_ERR:
				printk("[WIFI_ERR]\n");
				zq3_lvgl_wifi_status(&LCtx, false);
				zq3_lvgl_show_message(&LCtx, "Wifi Error\n(check settings)");
				break;
			case WIFIWAIT:
				printk("[WIFIWAIT]\n");
				zq3_lvgl_show_message(&LCtx, "Connecting...");
				break;
			case WIFI_UP:
				// Light up the wifi icon in the statusbar
				printk("[WIFI_UP]\n");
				zq3_lvgl_wifi_status(&LCtx, true);
				// Attempt to connect to the MQTT broker (once)
				int err = zq3_mqtt_connect(&MCtx);
				if (err) {
					ZCtx.state = MQTT_ERR;
				} else {
					ZCtx.state = CONNWAIT;
				}
				break;
			case MQTT_ERR:
				// Problem with MQTT settings, broker unreachable, etc.
				printk("[MQTT_ERR]\n");
				zq3_lvgl_show_message(&LCtx, "MQTT Error\n(check settings)");
				break;
			case CONNWAIT:
				// MQTT is connecting... just wait silently
				printk("[CONWAIT]\n");
				break;
			case CONNACK:
				// MQTT connected, so subscribe to topic
				printk("[CONNACK]\n");
				err = zq3_mqtt_subscribe(&MCtx);
				if (err) {
					ZCtx.state = MQTT_ERR;
				} else {
					ZCtx.state = SUBWAIT;
				}
				break;
			case SUBWAIT:
				printk("[SUBWAIT]\n");
				break;
			case SUBACK:
				printk("[SUBACK]\n");
				ZCtx.state = READY;
				break;
			case READY:
				printk("[READY]\n");

				// Reset toggle switch state to UNKNOWN/not-checked. It would
				// be possible to ask the broker for the topic's old value, but
				// I'm skipping that to keep the code simpler.
				ZCtx.toggle = UNKNOWN;
				zq3_lvgl_set_toggle(&LCtx, false);

				// Show the toggle switch in place of the status message
				zq3_lvgl_show_toggle(&LCtx);
				break;
			}
		}

		// Maintain MQTT connection
		if (ZCtx.state >= CONNWAIT) {
			// Respond to incoming MQTT messages if needed
			zq3_mqtt_poll(&MCtx);
			// Keep the connection up with pings
			zq3_mqtt_keepalive(&MCtx);
		}

		// If keypad press callback set the button press flag, handle it
		if (ZCtx.keypress) {
			ZCtx.keypress = false;
			switch(ZCtx.state) {
			case WIFI_ERR:
				// Retry from error state (maybe after changing settings)...
				// fall through to the OFFLINE case
			case OFFLINE:
				// Attempt to start a wifi connection
				printk("starting wifi connection\n");
				err = zq3_wifi_connect(ZCtx.ssid, ZCtx.psk);
				if (err) {
					ZCtx.state = WIFI_ERR;
					printk("ERR: wifi connect: %d\n", err);
				} else {
					ZCtx.state = WIFIWAIT;
				}
				break;
			case MQTT_ERR:
				// Trigger an MQTT connection retry attempt (maybe after
				// changing settings, fixing the MQTT broker, or whatever)
				ZCtx.state = WIFI_UP;
				break;
			case READY:
				// MQTT is up and ready: key press means toggle the switch
				// and publish its new value.
				//
				// This will apply the following transformations to .toggle:
				//   UKNOWN becomes ON
				//   OFF    becomes ON
				//   ON     becomes OFF
				bool new_state = ZCtx.toggle != ON;
				ZCtx.toggle = new_state ? ON : OFF;
				printk("Publishing toggle state: %d\n", new_state ? 1 : 0);
				err = zq3_mqtt_publish(&MCtx, new_state);
				if (err) {
					ZCtx.state = MQTT_ERR;
				}
				break;
			default:
				printk("Keypad pressed (NOP)\n");
			}
		}

		// Check if MQTT message requested a change to the toggle state
		if (ZCtx.got_0) {
			ZCtx.got_0 = false;
			ZCtx.toggle = OFF;
		}
		if (ZCtx.got_1) {
			ZCtx.got_1 = false;
			ZCtx.toggle = ON;
		}

		// Update toggle button widget if toggle stated has changed
		if (prev_toggle != ZCtx.toggle) {
			prev_toggle = ZCtx.toggle;
			switch(ZCtx.toggle) {
			case UNKNOWN:
				/* NOP */
				break;
			case OFF:
				zq3_lvgl_set_toggle(&LCtx, false);
				break;
			case ON:
				zq3_lvgl_set_toggle(&LCtx, true);
				break;
			}
		}

		// Call LVGL then sleep until time for the next tick
		uint32_t holdoff_ms = zq3_lvgl_timer_handler();
		k_msleep(holdoff_ms);
	}
}
```

## src/zq3.h
```c
/*
 * SPDX-FileCopyrightText: Copyright 2025 Sam Blenny
 * SPDX-License-Identifier: Apache-2.0
 */
#ifndef ZQ3_H
#define ZQ3_H

#include <zephyr/net/socket.h>  /* pollfd */


// Sequence of connection states from no-connectivity up to mqtt-ready-to-go.
typedef enum {
	OFFLINE,   // waiting for button press to initiate wifi connection
	WIFI_ERR,  // waiting for wifi error recovery (something went wrong)
	WIFIWAIT,  // waiting for wifi to connect
	WIFI_UP,   // wifi up, mqtt not connected to broker yet
	MQTT_ERR,  // waiting for error recovery (something went wrong)
	CONNWAIT,  // waiting for MQTT CONNACK event
	CONNACK,   // subscribe to MQTT topic
	SUBWAIT,   // waiting for MQTT SUBACK
	SUBACK,    // publish to /get topic modifier
	READY,     // task: respond to button pushes or publish events
} zq3_state;

// Possible states for local cached value of an MQTT toggle switch topic
typedef enum {
	UNKNOWN,  // toggle state unknown (because no MQTT connection yet, etc)
	OFF,      // toggle is off
	ON,       // toggle is on
} zq3_toggle;

// Adafruit IO MQTT broker auth credentials, hostname, topic, and scheme
typedef struct {
	char ssid[32];       // wifi ssid
	char psk[64];        // wifi WPA2 passphrase
	bool mqtt_ok;        // MQTT configuration is valid (url parse worked)
	zq3_state state;     // MQTT connection state (independent of wifi)
	bool keypress;       // flag to notify main loop of lvgl keypad press
	bool got_0;          // flag for receiving MQTT PUBLISH message "0"
	bool got_1;          // flag for receiving MQTT PUBLISH message "1"
	zq3_toggle toggle;   // current state of toggle switch
} zq3_context;


#endif /* ZQ3_H */
```

## src/zq3_cert.h
```c
/*
 * SPDX-FileCopyrightText: Copyright 2025 Sam Blenny
 * SPDX-License-Identifier: Apache-2.0
 *
 * Docs & Refs:
 * zephyr/samples/net/secure_mqtt_sensor_actuator/src/mqtt_client.c
 * zephyr/samples/net/secure_mqtt_sensor_actuator/src/tls_config/cert.h
 * zephyr/include/zephyr/net/tls_credentials.h
 *
 * DigiCert Root Authority Certificates download page
 * https://www.digicert.com/kb/digicert-root-certificates.htm
 */

#ifndef ZQ3_CERT_H
#define ZQ3_CERT_H

#include <zephyr/net/tls_credentials.h>


/*
 * This array is used in initializing the mqtt_sec_config struct as part of
 * setting up TLS for the MQTT connection. The tag numbers need to be unique,
 * and there should be one tag for each CA cert.
 */
static const sec_tag_t zq3_cert_tags[] = {1, 2, 3};

/*
 * This is the certificate for my self-signed CA, so it's useless to anybody
 * who isn't talking to the mosquitto broker on my private test network.
 *
 * But, if you want to make your own self-signed certificate, you could paste
 * that certificate here in place of mine. If you use 2048-bit RSA, it will
 * probably just work. For other key sizes or algorithms, you might need to
 * make adjustments to the code or Kconfig settings.
 */
static const char zq3_cert_self_signed[] =
	"-----BEGIN CERTIFICATE-----\r\n"
	"MIIDUTCCAjmgAwIBAgIUVUPZ9jLPLAFUurAcLfZNyliYmLMwDQYJKoZIhvcNAQEL\r\n"
	"BQAwODELMAkGA1UEBhMCVVMxDTALBgNVBAoMBE15Q0ExGjAYBgNVBAMMEU15IFNl\r\n"
	"bGYtU2lnbmVkIENBMB4XDTI1MDMyNDA3MTYxMloXDTI3MDMyNDA3MTYxMlowODEL\r\n"
	"MAkGA1UEBhMCVVMxDTALBgNVBAoMBE15Q0ExGjAYBgNVBAMMEU15IFNlbGYtU2ln\r\n"
	"bmVkIENBMIIBIjANBgkqhkiG9w0BAQEFAAOCAQ8AMIIBCgKCAQEA2rBJgpv+OyBr\r\n"
	"iO8HjZatn0DSWNFGsn5tl1hNl9chLbQCdlTO1rWKhUf/x9YYelO7C7CRzIZT7HYA\r\n"
	"eXxCQg+e0uf8Ufq9ZedGBhXJymBIIOoJpX9K4jYAMf6YVYsjjGgFmoiqLAIIJmuS\r\n"
	"+e2RbXc9kqCN/phe8XagqKKMfBBMQID+9vn6I1Was4uLDuulfFAq0+tJY+987pYw\r\n"
	"zTL9van5Q+/BlhKnScv75c9blnPfYfE0nrh0zXnEziGFgfPYD2lMYnMM4rMw3+AQ\r\n"
	"BREW3cevQs6AHvL/X+NuLwudIEShX/6+k8RI4I7GaC4MiUopYguFbhMgqh/kf7Rx\r\n"
	"dJygbrCLOQIDAQABo1MwUTAdBgNVHQ4EFgQU1Uq+LvLFqFu3/DSPWBe8PGnKG+Uw\r\n"
	"HwYDVR0jBBgwFoAU1Uq+LvLFqFu3/DSPWBe8PGnKG+UwDwYDVR0TAQH/BAUwAwEB\r\n"
	"/zANBgkqhkiG9w0BAQsFAAOCAQEAabXpeZJC8ZJBnqZNozFdOgfRTAczoW2buZ8P\r\n"
	"RmchlSSPhxKsh6gXHK0rr3qF2YKvKiTpp4d2g5DAse5ofhKk8kUB7zdaYfzED5wq\r\n"
	"QCEvvyPF56WJYg3VCkP4Gn2fwCPBek3++gDiqKBNiZsV0teOZ/NoI5q5UIT28E/e\r\n"
	"9qKd5xliqLbv6XJXI1SLc5Ftp9flmKjIwUL7A5sG6Q2lHAoS+t9ha99yEb87s/qr\r\n"
	"Xmu9aU6/B6PFf3M5XAbV5AlGsjD3Y6grn3DKJwKoMDvzCBE7XCYO2g/nHGLqYnwX\r\n"
	"sSnqXwvCR2cWE4z+dTSa9KeAhgt3qws9VnrmnK2c13qNKl9eQQ==\r\n"
	"-----END CERTIFICATE-----\r\n";

/*
 * This is the "DigiCert Global Root G2" certificate, which signs the
 * intermediate certificate, which signs the Adafruit IO server certificate
 * (as of March 2025). This is good until Jan 15, 2038. The public key is
 * 2048-bit RSA. I downloaded this from:
 *    https://www.digicert.com/kb/digicert-root-certificates.htm
 *
 * CAUTION: For mbed TLS to verify the server's certificate, it doesn't work
 * to just give an intermediate certificate here. You also need to give the
 * first certificate in the chain (root cert).
 */
static const char zq3_cert_digicert_global_root_g2[] =
	"-----BEGIN CERTIFICATE-----\r\n"
	"MIIDjjCCAnagAwIBAgIQAzrx5qcRqaC7KGSxHQn65TANBgkqhkiG9w0BAQsFADBh\r\n"
	"MQswCQYDVQQGEwJVUzEVMBMGA1UEChMMRGlnaUNlcnQgSW5jMRkwFwYDVQQLExB3\r\n"
	"d3cuZGlnaWNlcnQuY29tMSAwHgYDVQQDExdEaWdpQ2VydCBHbG9iYWwgUm9vdCBH\r\n"
	"MjAeFw0xMzA4MDExMjAwMDBaFw0zODAxMTUxMjAwMDBaMGExCzAJBgNVBAYTAlVT\r\n"
	"MRUwEwYDVQQKEwxEaWdpQ2VydCBJbmMxGTAXBgNVBAsTEHd3dy5kaWdpY2VydC5j\r\n"
	"b20xIDAeBgNVBAMTF0RpZ2lDZXJ0IEdsb2JhbCBSb290IEcyMIIBIjANBgkqhkiG\r\n"
	"9w0BAQEFAAOCAQ8AMIIBCgKCAQEAuzfNNNx7a8myaJCtSnX/RrohCgiN9RlUyfuI\r\n"
	"2/Ou8jqJkTx65qsGGmvPrC3oXgkkRLpimn7Wo6h+4FR1IAWsULecYxpsMNzaHxmx\r\n"
	"1x7e/dfgy5SDN67sH0NO3Xss0r0upS/kqbitOtSZpLYl6ZtrAGCSYP9PIUkY92eQ\r\n"
	"q2EGnI/yuum06ZIya7XzV+hdG82MHauVBJVJ8zUtluNJbd134/tJS7SsVQepj5Wz\r\n"
	"tCO7TG1F8PapspUwtP1MVYwnSlcUfIKdzXOS0xZKBgyMUNGPHgm+F6HmIcr9g+UQ\r\n"
	"vIOlCsRnKPZzFBQ9RnbDhxSJITRNrw9FDKZJobq7nMWxM4MphQIDAQABo0IwQDAP\r\n"
	"BgNVHRMBAf8EBTADAQH/MA4GA1UdDwEB/wQEAwIBhjAdBgNVHQ4EFgQUTiJUIBiV\r\n"
	"5uNu5g/6+rkS7QYXjzkwDQYJKoZIhvcNAQELBQADggEBAGBnKJRvDkhj6zHd6mcY\r\n"
	"1Yl9PMWLSn/pvtsrF9+wX3N3KjITOYFnQoQj8kVnNeyIv/iPsGEMNKSuIEyExtv4\r\n"
	"NeF22d+mQrvHRAiGfzZ0JFrabA0UWTW98kndth/Jsw1HKj2ZL7tcu7XUIOGZX1NG\r\n"
	"Fdtom/DzMNU+MeKNhJ7jitralj41E6Vf8PlwUHBHQRFXGU7Aj64GxJUTFy8bJZ91\r\n"
	"8rGOmaFvE7FBcf6IKshPECBV1/MUReXgRPTqh5Uykw7+U0b6LJ3/iyK5S9kJRaTe\r\n"
	"pLiaWN0bfVKfjllDiIGknibVb63dDcY3fe0Dkhvld1927jyNxF1WW6LZZm6zNTfl\r\n"
	"MrY=\r\n"
	"-----END CERTIFICATE-----\r\n";

/*
 * This is the "GeoTrust TLS RSA CA G1" intermediate certificate which signs
 * the current Adafruit IO server certificate (as of March 2025). The end date
 * for this one is Nov 2, 2027. The public key is 2048-bit RSA.
 *
 * You can check the current Adafruit IO certificate from a terminal:
 *    openssl s_client -showcerts -connect io.adafruit.com:8883
 */
static const char zq3_cert_geotrust_g1[] =
	"-----BEGIN CERTIFICATE-----\r\n"
	"MIIEjTCCA3WgAwIBAgIQDQd4KhM/xvmlcpbhMf/ReTANBgkqhkiG9w0BAQsFADBh\r\n"
	"MQswCQYDVQQGEwJVUzEVMBMGA1UEChMMRGlnaUNlcnQgSW5jMRkwFwYDVQQLExB3\r\n"
	"d3cuZGlnaWNlcnQuY29tMSAwHgYDVQQDExdEaWdpQ2VydCBHbG9iYWwgUm9vdCBH\r\n"
	"MjAeFw0xNzExMDIxMjIzMzdaFw0yNzExMDIxMjIzMzdaMGAxCzAJBgNVBAYTAlVT\r\n"
	"MRUwEwYDVQQKEwxEaWdpQ2VydCBJbmMxGTAXBgNVBAsTEHd3dy5kaWdpY2VydC5j\r\n"
	"b20xHzAdBgNVBAMTFkdlb1RydXN0IFRMUyBSU0EgQ0EgRzEwggEiMA0GCSqGSIb3\r\n"
	"DQEBAQUAA4IBDwAwggEKAoIBAQC+F+jsvikKy/65LWEx/TMkCDIuWegh1Ngwvm4Q\r\n"
	"yISgP7oU5d79eoySG3vOhC3w/3jEMuipoH1fBtp7m0tTpsYbAhch4XA7rfuD6whU\r\n"
	"gajeErLVxoiWMPkC/DnUvbgi74BJmdBiuGHQSd7LwsuXpTEGG9fYXcbTVN5SATYq\r\n"
	"DfbexbYxTMwVJWoVb6lrBEgM3gBBqiiAiy800xu1Nq07JdCIQkBsNpFtZbIZhsDS\r\n"
	"fzlGWP4wEmBQ3O67c+ZXkFr2DcrXBEtHam80Gp2SNhou2U5U7UesDL/xgLK6/0d7\r\n"
	"6TnEVMSUVJkZ8VeZr+IUIlvoLrtjLbqugb0T3OYXW+CQU0kBAgMBAAGjggFAMIIB\r\n"
	"PDAdBgNVHQ4EFgQUlE/UXYvkpOKmgP792PkA76O+AlcwHwYDVR0jBBgwFoAUTiJU\r\n"
	"IBiV5uNu5g/6+rkS7QYXjzkwDgYDVR0PAQH/BAQDAgGGMB0GA1UdJQQWMBQGCCsG\r\n"
	"AQUFBwMBBggrBgEFBQcDAjASBgNVHRMBAf8ECDAGAQH/AgEAMDQGCCsGAQUFBwEB\r\n"
	"BCgwJjAkBggrBgEFBQcwAYYYaHR0cDovL29jc3AuZGlnaWNlcnQuY29tMEIGA1Ud\r\n"
	"HwQ7MDkwN6A1oDOGMWh0dHA6Ly9jcmwzLmRpZ2ljZXJ0LmNvbS9EaWdpQ2VydEds\r\n"
	"b2JhbFJvb3RHMi5jcmwwPQYDVR0gBDYwNDAyBgRVHSAAMCowKAYIKwYBBQUHAgEW\r\n"
	"HGh0dHBzOi8vd3d3LmRpZ2ljZXJ0LmNvbS9DUFMwDQYJKoZIhvcNAQELBQADggEB\r\n"
	"AIIcBDqC6cWpyGUSXAjjAcYwsK4iiGF7KweG97i1RJz1kwZhRoo6orU1JtBYnjzB\r\n"
	"c4+/sXmnHJk3mlPyL1xuIAt9sMeC7+vreRIF5wFBC0MCN5sbHwhNN1JzKbifNeP5\r\n"
	"ozpZdQFmkCo+neBiKR6HqIA+LMTMCMMuv2khGGuPHmtDze4GmEGZtYLyF8EQpa5Y\r\n"
	"jPuV6k2Cr/N3XxFpT3hRpt/3usU/Zb9wfKPtWpoznZ4/44c1p9rzFcZYrWkj3A+7\r\n"
	"TNBJE0GmP2fhXhP1D/XVfIW/h0yCJGEiV9Glm/uGOa3DXHlmbAcxSyCRraG+ZBkA\r\n"
	"7h4SeM6Y8l/7MBRpPCz6l8Y=\r\n"
	"-----END CERTIFICATE-----\r\n";


#endif /* ZQ3_CERT_H */
```

## src/zq3_dns.c
```c
/*
 * SPDX-FileCopyrightText: Copyright 2025 Sam Blenny
 * SPDX-License-Identifier: Apache-2.0
 *
 * DNS & Socket Docs & Refs:
 * https://docs.zephyrproject.org/apidoc/latest/group__bsd__sockets.html
 * https://docs.zephyrproject.org/apidoc/latest/netdb_8h.html (getaddrinfo / freeaddrinfo)
 * https://github.com/zephyrproject-rtos/zephyr/blob/main/include/zephyr/net/dns_resolve.h
 * https://docs.zephyrproject.org/apidoc/latest/group__ip__4__6.html (net_addr_ntop)
 */

#include <zephyr/net/socket.h>
#include "zq3.h"


#define TLS_PORTSTR     ("8883")
#define TLS_PORT        (8883)
#define NON_TLS_PORTSTR ("1883")
#define NON_TLS_PORT    (1883)

// Resolve hostname to IPv4 IP (IPv6 not supported)
// This requires CONFIG_POSIX_API=y and CONFIG_NET_SOCKETS_POSIX_NAMES=y.
//
int zq3_dns_resolve(
	const uint8_t *name,
	bool tls,
	struct sockaddr_storage *addr
) {
	if (name == NULL || addr == NULL) {
		return -EINVAL;
	}
	struct addrinfo *res = NULL;
	const struct addrinfo hint = {
		.ai_family = AF_INET,
		.ai_socktype = SOCK_STREAM
	};
	printk("Attempting DNS lookup for '%s'\n", name);
	const char * service = tls ? TLS_PORTSTR : NON_TLS_PORTSTR;
	int err = getaddrinfo(name, service, &hint, &res);
	if (err) {
		switch(err) {
		case DNS_EAI_SYSTEM:
			printk("ERR: DNS_EAI_SYSTEM: Is wifi connected?\n");
			break;
		case DNS_EAI_CANCELED:
			// This happened to me while testing on a wifi router bridged to
			// a private Ethernet LAN with no gateway and no DNS server. In
			// that case, the DNS resolver still works fine for IP address
			// strings, but it can't do hostnames. Solution: use wifi network
			// that provides access to gateway router and DNS server.
			printk("ERR: DNS_EAI_SYSTEM: Did DHCP give you a DNS server?\n");
			break;
		default:
			// Look for enum with EAI_* in include/zephyr/net/dns_resolve.h
			printk("ERR: DNS fail %d\n", err);
		}
	} else if (!res || !(res->ai_addr) || (res->ai_family != AF_INET)) {
		// This shouldn't happen, but check anyway because null pointer
		// dereference hard faults are no fun.
		printk("ERR: DNS result struct was damaged\n");
	} else {
		// At this point, we can trust that res and res->ai_addr are not NULL
		// and that the result is an IPv4 address.

		// Copy IPv4 address from DNS lookup (src) to addr struct (dst)
		//
		// CAUTION! This uses weird pointer casting because that's how the
		// socket API expects you to handle the possibility that a DNS lookup
		// can resolve to either or both of IPv4 and IPv6 addresses.
		//
		// CAUTION: This ignores the possibility of more than one IP address
		// and just uses the address from the first result.
		//
		struct sockaddr_in *src = (struct sockaddr_in *)res->ai_addr;
		struct sockaddr_in *dst = (struct sockaddr_in *)addr;
		dst->sin_family = AF_INET;
		dst->sin_addr.s_addr = src->sin_addr.s_addr;
		// Set TLS or non-TLS port with network byte order conversion function
		dst->sin_port = htons(tls ? TLS_PORT : NON_TLS_PORT);

		// Debug print the DNS lookup result
		char ip_str[INET_ADDRSTRLEN];  // max length IPv4 address string
		net_addr_ntop(AF_INET, &dst->sin_addr, ip_str, sizeof(ip_str));
		printk("DNS IPv4 result: %s\n", ip_str);
	}
	// IMPORTANT: always free getaddrinfo() result to avoid memory leak
	freeaddrinfo(res);
	return err;
}
```

## src/zq3_dns.h
```c
/*
 * SPDX-FileCopyrightText: Copyright 2025 Sam Blenny
 * SPDX-License-Identifier: Apache-2.0
 */
#ifndef ZQ3_DNS_H
#define ZQ3_DNS_H

int zq3_dns_resolve(
	const uint8_t *name,
	bool tls,
	struct sockaddr_storage *addr
);

#endif /* ZQ3_DNS_H */
```

## src/zq3_mqtt.c
```c
/*
 * SPDX-FileCopyrightText: Copyright 2025 Sam Blenny
 * SPDX-License-Identifier: Apache-2.0
 *
 * AIO + MQTT Docs & Refs:
 * https://io.adafruit.com/api/docs/mqtt.html#adafruit-io-mqtt-api
 * https://docs.zephyrproject.org/latest/connectivity/networking/api/mqtt.html
 * https://docs.zephyrproject.org/latest/doxygen/html/structmqtt__evt.html
 * https://docs.zephyrproject.org/latest/doxygen/html/group__mqtt__socket.html
 * https://docs.zephyrproject.org/apidoc/latest/structsockaddr.html
 * https://docs.zephyrproject.org/latest/connectivity/networking/api/sockets.html
 * https://github.com/zephyrproject-rtos/zephyr/blob/main/include/zephyr/net/socket.h
 *
 * TLS Docs & Refs
 * https://docs.zephyrproject.org/latest/connectivity/networking/api/mqtt.html
 * https://docs.zephyrproject.org/latest/connectivity/networking/api/sockets.html
 * https://docs.zephyrproject.org/latest/doxygen/html/group__tls__credentials.html
 * zephyr/include/zephyr/net/mqtt.h  (struct mqtt_sec_config)
 * zephyr/include/zephyr/net/tls_credentials.h
 * zephyr/samples/net/secure_mqtt_sensor_actuator/src/mqtt_client.c
 * zephyr/samples/net/secure_mqtt_sensor_actuator/src/tls_config/cert.h
 *
 * Adafruit IO MQTT Settings:
 * host:port: io.adafruit.com:8883
 */

#include <zephyr/kernel.h>
#include <zephyr/net/mqtt.h>
#include <zephyr/net/tls_credentials.h>
#include "zq3.h"
#include "zq3_dns.h"
#include "zq3_mqtt.h"
#include "zq3_cert.h"


// Initialize MQTT
int zq3_mqtt_init(
	zq3_mqtt_context *mctx,
	void (*callback)(struct mqtt_client *, const struct mqtt_evt *)
) {
	// Clear string buffers to with '\0' before any strlen() calls
	memset(mctx->user_buf, 0, sizeof(mctx->user_buf));
	memset(mctx->pass_buf, 0, sizeof(mctx->pass_buf));
	memset(mctx->hostname, 0, sizeof(mctx->hostname));
	memset(mctx->topic, 0, sizeof(mctx->topic));
	// Initialize the MQTT API's client struct
	struct mqtt_client *c = &mctx->client;
	mqtt_client_init(c);
	mctx->pass.utf8 = mctx->pass_buf;
	mctx->user.utf8 = mctx->user_buf;
	mctx->pass.size = 0;
	mctx->user.size = 0;
	c->password = &mctx->pass;
	c->user_name = &mctx->user;
	c->broker = &mctx->broker;
	c->evt_cb = callback;
	c->client_id.utf8 = (uint8_t *)"i";  // protocol requires non-empty id
	c->client_id.size = strlen("i");
	c->password = &mctx->pass;
	c->user_name = &mctx->user;
	c->protocol_version = MQTT_VERSION_3_1_1;
	c->rx_buf = mctx->rx_buf;
	c->rx_buf_size = sizeof(mctx->rx_buf);
	c->tx_buf = mctx->tx_buf;
	c->tx_buf_size = sizeof(mctx->tx_buf);
	// Start by assuming TLS is turned on
	c->transport.type = MQTT_TRANSPORT_SECURE;
	mctx->tls = true;
    // Register the TLS CA certificates from zq3_certs.h
	int err;
	const char fmt[] = "ERR: tls_credential_add(%d, ...) = %d\n";
	// This one is for the broker on my private testbench LAN. You can omit
	// it or replace it with your own self-signed testing cert in zq3_cert.h
	err = tls_credential_add(zq3_cert_tags[0], TLS_CREDENTIAL_CA_CERTIFICATE,
		zq3_cert_self_signed, sizeof(zq3_cert_self_signed));
	if (err) {
		printk(fmt, zq3_cert_tags[0], err);
	}
	// This is the root certificate used by the certificate chain for
	// io.adafruit.com. You need this to talk to Adafruit IO.
	err = tls_credential_add(zq3_cert_tags[1], TLS_CREDENTIAL_CA_CERTIFICATE,
		zq3_cert_digicert_global_root_g2,
		sizeof(zq3_cert_digicert_global_root_g2));
	if (err) {
		printk(fmt, zq3_cert_tags[1], err);
	}

	// This is the intermediate certificate for io.adafruit.com. You need this
	// to talk to Adafruit IO
	err = tls_credential_add(zq3_cert_tags[2], TLS_CREDENTIAL_CA_CERTIFICATE,
		zq3_cert_geotrust_g1, sizeof(zq3_cert_geotrust_g1));
	if (err) {
		printk(fmt, zq3_cert_tags[2], err);
	}
	// Configure TLS stuff in the MQTT client struct
	struct mqtt_sec_config *conf = &mctx->client.transport.tls.config;
	conf->peer_verify = TLS_PEER_VERIFY_REQUIRED;
	conf->cipher_list = NULL;
	conf->sec_tag_list = zq3_cert_tags;
	conf->sec_tag_count = sizeof(zq3_cert_tags)/sizeof(zq3_cert_tags[0]);
	conf->hostname = mctx->hostname;
	return 0;
}

// Update context for TLS enabled (port 8883) or disabled (port 1883)
int zq3_mqtt_set_tls(zq3_mqtt_context *mctx, bool enabled) {
	if (enabled) {
		mctx->client.transport.type = MQTT_TRANSPORT_SECURE;
		mctx->tls = true;
	} else {
		mctx->client.transport.type = MQTT_TRANSPORT_NON_SECURE;
		mctx->tls = false;
	}
	return 0;
}

int zq3_mqtt_set_username(zq3_mqtt_context *mctx, const char *src, int len) {
	if (src == NULL) {
		return -EINVAL;
	}
	if (len >= sizeof(mctx->user_buf)) {
		return -EDOM;
	}
	memset(mctx->user_buf, 0, sizeof(mctx->user_buf));
	memcpy(mctx->user_buf, src, len);
	mctx->client.user_name = &mctx->user;
	mctx->client.user_name->utf8 = mctx->user_buf;
	mctx->client.user_name->size = strlen(mctx->user_buf);
	return 0;
}

int zq3_mqtt_set_password(zq3_mqtt_context *mctx, const char *src, int len) {
	if (src == NULL) {
		return -EINVAL;
	}
	if (len >= sizeof(mctx->pass_buf)) {
		return -EDOM;
	}
	memset(mctx->pass_buf, 0, sizeof(mctx->pass_buf));
	memcpy(mctx->pass_buf, src, len);
	mctx->client.password = &mctx->pass;
	mctx->client.password->utf8 = mctx->pass_buf;
	mctx->client.password->size = strlen(mctx->pass_buf);
	return 0;
}

int zq3_mqtt_set_topic(zq3_mqtt_context *mctx, const char *src, int len) {
	if (src == NULL) {
		return -EINVAL;
	}
	if (len >= sizeof(mctx->topic)) {
		return -EDOM;
	}
	memset(mctx->topic, 0, sizeof(mctx->topic));
	memcpy(mctx->topic, src, len);
	return 0;
}

int zq3_mqtt_set_hostname(zq3_mqtt_context *mctx, const char *src, int len) {
	if (src == NULL) {
		return -EINVAL;
	}
	if (len >= sizeof(mctx->hostname)) {
		return -EDOM;
	}
	memset(mctx->hostname, 0, sizeof(mctx->hostname));
	memcpy(mctx->hostname, src, len);
	return 0;
}

// Once MQTT connection is up, event loop calls this to start subscription.
// This is hardcoded to subscribe to the one topic specified in zq3_context.
// Related docs:
// - https://docs.zephyrproject.org/latest/doxygen/html/structmqtt__subscription__list.html
// - https://docs.zephyrproject.org/latest/doxygen/html/structmqtt__topic.html
// - https://docs.zephyrproject.org/latest/doxygen/html/structmqtt__utf8.html
//
int zq3_mqtt_subscribe(zq3_mqtt_context *mctx) {
	// This uses a C99 compound literal to initialize a nested struct
	struct mqtt_subscription_list list = {
		.list = &(struct mqtt_topic){
			.topic = (struct mqtt_utf8){
				.utf8 = mctx->topic,
				.size = strlen(mctx->topic)
			},
			.qos = MQTT_QOS_0_AT_MOST_ONCE
		},
		.list_count = 1,
		.message_id = 1
	};
	// Send the subscription request
	int err = mqtt_subscribe(&mctx->client, &list);
	if(err) {
		// https://docs.zephyrproject.org/apidoc/latest/errno_8h.html
		printk("ERR: mqtt_subscribe() = %d\n", err);
	}
	return err;
}


// Publish new toggle switch state to the topic.
// Related docs:
// - https://docs.zephyrproject.org/latest/doxygen/html/structmqtt__publish__param.html
// - https://docs.zephyrproject.org/latest/doxygen/html/structmqtt__publish__message.html
// - https://docs.zephyrproject.org/latest/doxygen/html/structmqtt__topic.html
// - https://docs.zephyrproject.org/latest/doxygen/html/structmqtt__utf8.html
// - https://docs.zephyrproject.org/latest/doxygen/html/structmqtt__binstr.html
//
int
zq3_mqtt_publish(zq3_mqtt_context *mctx, bool toggle)
{
	char * state = toggle ? "1" : "0";
	// Build a C99 compound literal representing the message to be published
	const struct mqtt_publish_param param = {
		.message = (struct mqtt_publish_message){
			.topic = (struct mqtt_topic){
				.topic = (struct mqtt_utf8){
					.utf8 = mctx->topic,
					.size = strlen(mctx->topic),
				},
				.qos = MQTT_QOS_0_AT_MOST_ONCE,
			},
			.payload = (struct mqtt_binstr){
				.data = (uint8_t *)state,
				.len = strlen(state),
			},
		},
		.message_id = 0,
		.dup_flag = 0,
		.retain_flag = 0,
	};
	// Publish it
	int err = mqtt_publish(&mctx->client, &param);
	if (err) {
		printk("ERR: mqtt_publish() = %d\n", err);
	}
	return err;
}


// Connect to MQTT broker
int zq3_mqtt_connect(zq3_mqtt_context *mctx) {
	// Use DNS to resolve hostname to IPv4 IP (IPv6 not supported)
	int err = zq3_dns_resolve(mctx->hostname, mctx->tls,
		(struct sockaddr_storage *)mctx->client.broker);
	if (err) {
		return err;
	}

	err = mqtt_connect(&mctx->client);
	if(err) {
		// https://docs.zephyrproject.org/apidoc/latest/errno_8h.html
		const char *fmt = "ERR: mqtt_connect() = %d %s\n";
		switch(-err) {
		case ENOENT:
			printk(fmt, err, "ENOENT: TLS CA cert valid?");
			break;
		case ECONNREFUSED:
			printk(fmt, err, "ECONNREFUSED: Broker service running?");
			break;
		default:
			printk(fmt, err, "");
		}
		return err;
	}
	if (mctx->tls) {
		mctx->fds[0].fd = mctx->client.transport.tls.sock;
	} else {
		mctx->fds[0].fd = mctx->client.transport.tcp.sock;
	}
	mctx->fds[0].events = ZSOCK_POLLIN;
	return 0;
}

// Poll for incoming packets (note: poll() requires CONFIG_POSIX_API=y)
int zq3_mqtt_poll(zq3_mqtt_context *mctx) {
	if (poll(mctx->fds, 1, 0) > 0) {
		return mqtt_input(&mctx->client);
	}
	return 0;
}

// Send an MQTT PINGREQ ping several seconds before the keepalive timer is due
// to run out. This keeps the TCP connection to the MQTT broker open so it can
// send us messages on subscribed topics as they are published.
//
int zq3_mqtt_keepalive(zq3_mqtt_context *mctx) {
	int remaining_ms = mqtt_keepalive_time_left(&mctx->client);
	if (remaining_ms < 5000) {
		return mqtt_live(&mctx->client);
	}
	return 0;
}

// Disconnect from MQTT broker
int zq3_mqtt_disconnect(zq3_mqtt_context *mctx) {
	int err = mqtt_disconnect(&mctx->client);
	if(err) {
		// https://docs.zephyrproject.org/apidoc/latest/errno_8h.html
		switch(-err) {
		case ENOTCONN:
			printk("ERR: Socket was not connected\n");
			break;
		default:
			printk("ERR: %d\n", err);
		}
		return err;
	}
	return 0;
}
```

## src/zq3_mqtt.h
```c
/*
 * SPDX-FileCopyrightText: Copyright 2025 Sam Blenny
 * SPDX-License-Identifier: Apache-2.0
 */
#ifndef ZQ3_MQTT_H
#define ZQ3_MQTT_H

#include <zephyr/net/mqtt.h>  /* struct mqtt_client */
#include "zq3.h"              /* zq3_context */


// To use an mqtt_client struct, you always need some other buffers and a
// socket address struct for the broker's network address. This context struct
// groups all that stuff together so it's easy to pass the pointer around.
//
// For the fds file descriptor array, the examples in Zephyr project MQTT docs
// use the pollfd type and the poll() function, both of which gave me compiler
// errors until I figured out I needed CONFIG_POSIX_API=y. Note that docs may
// refer to zsock_pollfd and zsock_poll(). See zephyr/net/socket.h.
//
typedef struct {
	uint8_t rx_buf[256];
	uint8_t tx_buf[256];
	uint8_t user_buf[48];            // MQTT username string buffer
	uint8_t pass_buf[48];            // MQTT password string buffer
	uint8_t topic[48];               // MQTT topic string buffer
	uint8_t hostname[48];            // MQTT broker hostname string buffer
	struct mqtt_utf8 pass;           // UTF-8 password struct
	struct mqtt_utf8 user;           // UTF-8 username struct
	struct sockaddr_storage broker;  // Broker network address struct union
	struct mqtt_client client;       // client struct for mqtt_*() API funcs
	struct pollfd fds[1];            // socket file descriptor
	bool tls;                        // true: port 8883+TLS, false: port 1883
} zq3_mqtt_context;

#define ZQ3_MQTT_URL_MAX_LEN (sizeof("mqtts://:@") + \
	sizeof(((zq3_mqtt_context *)0)->user_buf) + \
	sizeof(((zq3_mqtt_context *)0)->pass_buf) + \
	sizeof(((zq3_mqtt_context *)0)->hostname) + \
	sizeof(((zq3_mqtt_context *)0)->topic))

int zq3_mqtt_init(
	zq3_mqtt_context *mctx,
	void (*callback)(struct mqtt_client *, const struct mqtt_evt *)
);

int zq3_mqtt_set_tls(zq3_mqtt_context *mctx, bool enabled);

int zq3_mqtt_set_username(zq3_mqtt_context *mctx, const char *src, int len);

int zq3_mqtt_set_password(zq3_mqtt_context *mctx, const char *src, int len);

int zq3_mqtt_set_hostname(zq3_mqtt_context *mctx, const char *src, int len);

int zq3_mqtt_set_topic(zq3_mqtt_context *mctx, const char *src, int len);

int zq3_mqtt_subscribe(zq3_mqtt_context *mctx);

int zq3_mqtt_publish(zq3_mqtt_context *mctx, bool toggle);

int zq3_mqtt_connect(zq3_mqtt_context *mctx);

int zq3_mqtt_poll(zq3_mqtt_context *mctx);

int zq3_mqtt_keepalive(zq3_mqtt_context *mctx);

int zq3_mqtt_disconnect(zq3_mqtt_context *mctx);

#endif /* ZQ3_MQTT_H */
```

## src/zq3_url.c
```c
/*
 * SPDX-FileCopyrightText: Copyright 2025 Sam Blenny
 * SPDX-License-Identifier: Apache-2.0
 */

#include "zq3_mqtt.h"


// Parse an MQTT broker url into fields of the zq3_mqtt_context struct
// Examples of expected url format (TLS and non-TLS):
//   mqtts://Blinka:password@io.adafruit.com/Blinka/feeds/test
//   mqtt://:@192.168.0.50/test
//
int zq3_url_parse(zq3_mqtt_context *mctx, const char *url) {
	const char *cursor = url;

	// Parse URL scheme prefix (should be "mqtt://" or "mqtts://")
	char *tls_scheme = "mqtts://";
	char *nontls_scheme = "mqtt://";
	if (strncmp(url, tls_scheme, strlen(tls_scheme)) == 0) {
		// Scheme = MQTT with TLS
		cursor += strlen(tls_scheme);
		zq3_mqtt_set_tls(mctx, true);
	} else if (strncmp(url, nontls_scheme, strlen(nontls_scheme)) == 0) {
		// Scheme = unencrypted MQTT
		cursor += strlen(nontls_scheme);
		zq3_mqtt_set_tls(mctx, false);
	} else {
		printk("ERROR: expected mqtt:// or mqtts://\n");
		return -EINVAL;
	}

	// Parse username (whatever is between end of scheme and the next ':')
	char *delim = strchr((char *)cursor, ':');
	int len = delim - cursor;
	if (!delim || len < 0) {
		printk("ERR: missing ':' after username\n");
		return -EINVAL;
	} else if (len >= sizeof(mctx->user_buf)) {
		printk("ERR: username too long\n");
		return -EINVAL;
	} else {
		// Copy username string
		zq3_mqtt_set_username(mctx, cursor, len);
		cursor = delim + 1;
	}

	// Parse password (whatever is between ':' and '@')
	delim = strchr((char *)cursor, '@');
	len = delim - cursor;
	if (!delim || len < 0) {
		printk("ERR: missing '@' after password\n");
		return -EINVAL;
	} else if (len >= sizeof(mctx->pass_buf)) {
		printk("ERR: password too long\n");
		return -EINVAL;
	} else {
		// Copy password string
		zq3_mqtt_set_password(mctx, cursor, len);
		cursor = delim + 1;
	}

	// Parse host (whatever is between '@' and '/')
	delim = strchr((char *)cursor, '/');
	len = delim - cursor;
	if (!delim) {
		printk("ERR: missing '/' after hostname\n");
		return -EINVAL;
	} else if (len < 1) {
		printk("ERR: hostname can't be blank\n");
		return -EINVAL;
	} else if (len >= sizeof(mctx->hostname)) {
		printk("ERR: hostname too long\n");
		return -EINVAL;
	} else {
		// Copy hostname string
		zq3_mqtt_set_hostname(mctx, cursor, len);
		cursor = delim + 1;
	}

	// Parse topic (whatever is after '/')
	len = strlen(cursor);
	if (len <= 0) {
		printk("ERR: topic can't be blank\n");
		return -EINVAL;
	} else if (len >= sizeof(mctx->topic)) {
		printk("ERR: topic too long\n");
		return -EINVAL;
	} else {
		// Copy topic string
		zq3_mqtt_set_topic(mctx, cursor, len);
	}

	return 0;
}
```

## src/zq3_url.h
```c
/*
 * SPDX-FileCopyrightText: Copyright 2025 Sam Blenny
 * SPDX-License-Identifier: Apache-2.0
 */
#ifndef ZQ3_URL_H
#define ZQ3_URL_H

#include "zq3_mqtt.h"


int zq3_url_parse(zq3_mqtt_context *mctx, const char *url);


#endif /* ZQ3_URL_H */
```
