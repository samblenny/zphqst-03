/*
 * Copyright (c) 2023 Espressif Systems (Shanghai) Co., Ltd.
 * Copyright (c) 2025 Sam Blenny
 *
 * SPDX-License-Identifier: Apache-2.0
 *
 * Derived from zephyr/boards/espressif/esp32s3_devkitm
 * Modifications by Sam Blenny to work with Feather TFT ESP32-S3
 */
/dts-v1/;

#include <espressif/esp32s3/esp32s3_mini_n4r2.dtsi>
#include <espressif/partitions_0x0_amp.dtsi>
#include "feather_tft_esp32s3-pinctrl.dtsi"
#include "feather_connector.dtsi"

/ {
	model = "Adafruit Feather TFT ESP32-S3 PSRAM APPCPU";
	compatible = "espressif,esp32s3";

	/* For esp32s3 devicetree definitions provided by espressif, see:
	*  - zephyr/dts/xtensa/espressif/esp32s3/esp32s3_mini_n4r2.dtsi
	*  - zephyr/dts/xtensa/espressif/esp32s3/esp32s3_common.dtsi
	*  - zephyr/dts/common/espressif/partitions_0x0_amp_4M.dtsi
	*/
	chosen {
		zephyr,sram = &sram1;
		zephyr,ipc_shm = &shm0;
		zephyr,ipc = &ipm0;
		zephyr,flash = &flash0;
		zephyr,code-partition = &slot0_appcpu_partition;
	};
};

&trng0 {
	status = "okay";
};

&ipm0 {
	status = "okay";
};
