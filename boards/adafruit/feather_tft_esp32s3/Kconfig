## boards/adafruit/feather_tft_esp32s3/Kconfig
```kconfig
# Copyright (c) 2024 Espressif Systems (Shanghai) Co., Ltd.
# Copyright (c) 2025 Sam Blenny
# SPDX-License-Identifier: Apache-2.0
# Derived from zephyr/boards/espressif/esp32s3_devkitm
# Modifications by Sam Blenny to work with Feather TFT ESP32-S3

config HEAP_MEM_POOL_ADD_SIZE_BOARD
	int
	default 4096 if BOARD_FEATHER_TFT_ESP32S3_PROCPU
	default 256 if BOARD_FEATHER_TFT_ESP32S3_APPCPU
```

## boards/adafruit/feather_tft_esp32s3/Kconfig.feather_tft_esp32s3
```kconfig
# Copyright (c) 2022 Espressif Systems (Shanghai) Co., Ltd.
# Copyright (c) 2025 Sam Blenny
# SPDX-License-Identifier: Apache-2.0
# Derived from zephyr/boards/espressif/esp32s3_devkitm
# Modifications by Sam Blenny to work with Feather TFT ESP32-S3 (s/_N8/_N4R2/)

config BOARD_FEATHER_TFT_ESP32S3
	select SOC_ESP32S3_MINI_N4R2
	select SOC_ESP32S3_PROCPU if BOARD_FEATHER_TFT_ESP32S3_ESP32S3_PROCPU
	select SOC_ESP32S3_APPCPU if BOARD_FEATHER_TFT_ESP32S3_ESP32S3_APPCPU
```

## boards/adafruit/feather_tft_esp32s3/Kconfig.sysbuild
```kconfig
# Copyright (c) 2023 Espressif Systems (Shanghai) Co., Ltd.
# SPDX-License-Identifier: Apache-2.0
# Derived from zephyr/boards/espressif/esp32s3_devkitm
# Modifications by Sam Blenny to work with Feather TFT ESP32-S3

choice BOOTLOADER
	default BOOTLOADER_MCUBOOT
endchoice

choice BOOT_SIGNATURE_TYPE
	default BOOT_SIGNATURE_TYPE_NONE
endchoice
```

## boards/adafruit/feather_tft_esp32s3/board.yml
```yaml
board:
  name: feather_tft_esp32s3
  full_name: Adafruit Feather TFT ESP32-S3
  vendor: adafruit
  socs:
  - name: esp32s3
```

## boards/adafruit/feather_tft_esp32s3/feather_tft_esp32s3_procpu_defconfig
```kconfig
# SPDX-License-Identifier: Apache-2.0
# Derived from zephyr/boards/espressif/esp32s3_devkitm

CONFIG_CONSOLE=y
CONFIG_SERIAL=y
CONFIG_UART_CONSOLE=y
CONFIG_GPIO=y
CONFIG_CLOCK_CONTROL=y

# This allows samples/basic/button to build by preventing errors about
# "undefined reference to `k_malloc'"
CONFIG_HEAP_MEM_POOL_SIZE=1024
```
